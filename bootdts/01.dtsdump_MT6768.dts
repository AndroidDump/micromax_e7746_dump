/dts-v1/;

/ {
	model = "MT6768";
	compatible = "mediatek,MT6768";
	interrupt-parent = <0x1>;
	#address-cells = <0x2>;
	#size-cells = <0x2>;

	chosen {
		bootargs = "console=tty0 console=ttyS0,921600n1 root=/dev/ram vmalloc=400M slub_debug=OFZPU swiotlb=noforce cgroup.memory=nosocket,nokmem firmware_class.path=/vendor/firmware page_owner=on loop.max_part=7";
		kaslr-seed = <0x0 0x0>;
		phandle = <0x63>;
	};

	cpus {
		#address-cells = <0x1>;
		#size-cells = <0x0>;

		cpu@000 {
			device_type = "cpu";
			compatible = "arm,cortex-a55";
			reg = <0x0>;
			enable-method = "psci";
			clock-frequency = <0x65633340>;
			cpu-idle-states = <0x2 0x3 0x4 0x5 0x6 0x7 0x8>;
			phandle = <0x9>;
		};

		cpu@001 {
			device_type = "cpu";
			compatible = "arm,cortex-a55";
			reg = <0x100>;
			enable-method = "psci";
			clock-frequency = <0x65633340>;
			cpu-idle-states = <0x2 0x3 0x4 0x5 0x6 0x7 0x8>;
			phandle = <0xa>;
		};

		cpu@002 {
			device_type = "cpu";
			compatible = "arm,cortex-a55";
			reg = <0x200>;
			enable-method = "psci";
			clock-frequency = <0x65633340>;
			cpu-idle-states = <0x2 0x3 0x4 0x5 0x6 0x7 0x8>;
			phandle = <0xb>;
		};

		cpu@003 {
			device_type = "cpu";
			compatible = "arm,cortex-a55";
			reg = <0x300>;
			enable-method = "psci";
			clock-frequency = <0x65633340>;
			cpu-idle-states = <0x2 0x3 0x4 0x5 0x6 0x7 0x8>;
			phandle = <0xc>;
		};

		cpu@100 {
			device_type = "cpu";
			compatible = "arm,cortex-a55";
			reg = <0x400>;
			enable-method = "psci";
			clock-frequency = <0x65633340>;
			cpu-idle-states = <0x2 0x3 0x4 0x5 0x6 0x7 0x8>;
			phandle = <0xd>;
		};

		cpu@101 {
			device_type = "cpu";
			compatible = "arm,cortex-a55";
			reg = <0x500>;
			enable-method = "psci";
			clock-frequency = <0x65633340>;
			cpu-idle-states = <0x2 0x3 0x4 0x5 0x6 0x7 0x8>;
			phandle = <0xe>;
		};

		cpu@102 {
			device_type = "cpu";
			compatible = "arm,cortex-a75";
			reg = <0x600>;
			enable-method = "psci";
			clock-frequency = <0x8166d4c0>;
			cpu-idle-states = <0x2 0x3 0x4 0x5 0x6 0x7 0x8>;
			phandle = <0xf>;
		};

		cpu@103 {
			device_type = "cpu";
			compatible = "arm,cortex-a75";
			reg = <0x700>;
			enable-method = "psci";
			clock-frequency = <0x8166d4c0>;
			cpu-idle-states = <0x2 0x3 0x4 0x5 0x6 0x7 0x8>;
			phandle = <0x10>;
		};

		cpu-map {

			cluster0 {

				core0 {
					cpu = <0x9>;
				};

				core1 {
					cpu = <0xa>;
				};

				core2 {
					cpu = <0xb>;
				};

				core3 {
					cpu = <0xc>;
				};

				core4 {
					cpu = <0xd>;
				};

				core5 {
					cpu = <0xe>;
				};

				doe {
					phandle = <0x64>;
				};
			};

			cluster1 {

				core0 {
					cpu = <0xf>;
				};

				core1 {
					cpu = <0x10>;
				};

				doe {
					phandle = <0x65>;
				};
			};
		};

		idle-states {
			entry-method = "arm,psci";

			standby {
				compatible = "arm,idle-state";
				arm,psci-suspend-param = <0x1>;
				entry-latency-us = <0x258>;
				exit-latency-us = <0x258>;
				min-residency-us = <0x4b0>;
				phandle = <0x2>;
			};

			mcdi-cpu {
				compatible = "arm,idle-state";
				arm,psci-suspend-param = <0x10001>;
				entry-latency-us = <0x258>;
				exit-latency-us = <0x258>;
				min-residency-us = <0x4b0>;
				phandle = <0x3>;
			};

			mcdi-cluster {
				compatible = "arm,idle-state";
				arm,psci-suspend-param = <0x1010001>;
				entry-latency-us = <0x258>;
				exit-latency-us = <0x258>;
				min-residency-us = <0x4b0>;
				phandle = <0x4>;
			};

			idledram {
				compatible = "arm,idle-state";
				arm,psci-suspend-param = <0x1010002>;
				entry-latency-us = <0x320>;
				exit-latency-us = <0x3e8>;
				min-residency-us = <0x7d0>;
				status = "okay";
				phandle = <0x5>;
			};

			idlesyspll {
				compatible = "arm,idle-state";
				arm,psci-suspend-param = <0x1010003>;
				entry-latency-us = <0x320>;
				exit-latency-us = <0x3e8>;
				min-residency-us = <0x7d0>;
				status = "okay";
				phandle = <0x6>;
			};

			idlebus26m {
				compatible = "arm,idle-state";
				arm,psci-suspend-param = <0x1010004>;
				entry-latency-us = <0x320>;
				exit-latency-us = <0x3e8>;
				min-residency-us = <0x7d0>;
				status = "okay";
				phandle = <0x7>;
			};

			suspend {
				compatible = "arm,idle-state";
				arm,psci-suspend-param = <0x1010005>;
				entry-latency-us = <0x320>;
				exit-latency-us = <0x3e8>;
				min-residency-us = <0x7d0>;
				phandle = <0x8>;
			};
		};
	};

	cache_parity {
		compatible = "mediatek,cache_parity";
		version = <0x1>;
		reg = <0x0 0xc530000 0x0 0x10000>;
		err_level = <0x1>;
		irq_config = <0x0 0x8090 0xff00 0x8090 0x44 0x8090 0xff 0x1 0x8090 0xff00 0x8090 0x44 0x8090 0xff 0x2 0x8090 0xff00 0x8090 0x44 0x8090 0xff 0x3 0x8090 0xff00 0x8090 0x44 0x8090 0xff 0x4 0x8090 0xff00 0x8090 0x44 0x8090 0xff 0x5 0x8090 0xff00 0x8090 0x44 0x8090 0xff 0x6 0x8090 0xff00 0x8090 0x44 0x8090 0xff 0x7 0x8090 0xff00 0x8090 0x44 0x8090 0xff 0x400 0xc8c0 0x1000000 0xc8c0 0xc 0xc8c8 0x1>;
		interrupts = <0x0 0x16 0x4 0x0 0x17 0x4 0x0 0x18 0x4 0x0 0x19 0x4 0x0 0x1a 0x4 0x0 0x1b 0x4 0x0 0x1c 0x4 0x0 0x1d 0x4 0x0 0x13 0x4>;
	};

	memory {
		device_type = "memory";
		reg = <0x0 0x40000000 0x0 0x3e605000>;
	};

	psci {
		compatible = "arm,psci-1.0";
		method = "smc";
	};

	mobicore {
		compatible = "trustonic,mobicore";
		interrupts = <0x0 0x129 0x1>;
	};

	utos {
		compatible = "microtrust,utos";
		interrupts = <0x0 0x12b 0x1 0x0 0x12c 0x1>;
	};

	utos_tester {
		compatible = "microtrust,tester-v1";
	};

	pmu {
		compatible = "arm,armv8-pmuv3";
		interrupt-parent = <0x11>;
		interrupts = <0x1 0x7 0x8>;
	};

	dsu-pmu-0 {
		compatible = "arm,dsu-pmu";
		interrupts = <0x0 0x12 0x4>;
		cpus = <0x9 0xa 0xb 0xc 0xd 0xe 0xf 0x10>;
	};

	reserved-memory {
		#address-cells = <0x2>;
		#size-cells = <0x2>;
		ranges;
		phandle = <0x66>;

		zmc-default {
			compatible = "mediatek,zone_movable_cma";
			size = <0x0 0x2d000000>;
			alignment = <0x0 0x1000000>;
			alloc-ranges = <0x0 0xc0000000 0x4 0x0>;
		};

		reserve-memory-sspm_share {
			compatible = "mediatek,reserve-memory-sspm_share";
			no-map;
			status = "okay";
			size = <0x0 0x510000>;
			alignment = <0x0 0x10000>;
			alloc-ranges = <0x0 0x40000000 0x0 0x60000000>;
		};

		reserve-memory-scp_share {
			compatible = "mediatek,reserve-memory-scp_share";
			no-map;
			size = <0x0 0x300000>;
			alignment = <0x0 0x1000000>;
			alloc-ranges = <0x0 0x40000000 0x0 0x50000000>;
		};

		ion-carveout-heap {
			compatible = "mediatek,ion-carveout-heap";
			no-map;
			size = <0x0 0x4000>;
			alignment = <0x0 0x1000>;
			alloc-ranges = <0x0 0x40000000 0x0 0x80000000>;
		};

		consys-reserve-memory {
			compatible = "mediatek,consys-reserve-memory";
			no-map;
			size = <0x0 0x400000>;
			alignment = <0x0 0x1000000>;
			alloc-ranges = <0x0 0x40000000 0x0 0x80000000>;
		};

		wifi-reserve-memory {
			compatible = "mediatek,wifi-reserve-memory";
			no-map;
			size = <0x0 0x300000>;
			alignment = <0x0 0x1000000>;
			alloc-ranges = <0x0 0x40000000 0x0 0x80000000>;
		};

		soter-shared-mem {
			compatible = "microtrust,shared_mem";
			no-map;
			size = <0x0 0x200000>;
			alignment = <0x0 0x200000>;
			alloc-ranges = <0x0 0x40000000 0x0 0x50000000>;
		};
	};

	cpu_dbgapb@0e010000 {
		compatible = "mediatek,hw_dbg";
		num = <0x8>;
		reg = <0x0 0xe010000 0x0 0x1000 0x0 0xe110000 0x0 0x1000 0x0 0xe210000 0x0 0x1000 0x0 0xe310000 0x0 0x1000 0x0 0xe410000 0x0 0x1000 0x0 0xe510000 0x0 0x1000 0x0 0xe610000 0x0 0x1000 0x0 0xe710000 0x0 0x1000>;
		phandle = <0x67>;
	};

	interrupt-controller {
		compatible = "arm,gic-v3";
		#interrupt-cells = <0x3>;
		#address-cells = <0x2>;
		#size-cells = <0x2>;
		#redistributor-regions = <0x1>;
		interrupt-parent = <0x11>;
		interrupt-controller;
		reg = <0x0 0xc000000 0x0 0x40000 0x0 0xc040000 0x0 0x200000 0x0 0xc53a650 0x0 0x50>;
		interrupts = <0x1 0x9 0x4>;
		phandle = <0x11>;
	};

	intpol-controller@0 {
		compatible = "mediatek,mt6577-sysirq";
		interrupt-controller;
		#interrupt-cells = <0x3>;
		interrupt-parent = <0x11>;
		reg = <0x0 0xc53a650 0x0 0x50>;
		phandle = <0x1>;
	};

	chipid@08000000 {
		compatible = "mediatek,chipid";
		reg = <0x0 0x8000000 0x0 0x4 0x0 0x8000004 0x0 0x4 0x0 0x8000008 0x0 0x4 0x0 0x800000c 0x0 0x4>;
	};

	timer {
		compatible = "arm,armv8-timer";
		interrupt-parent = <0x11>;
		interrupts = <0x1 0xd 0x8 0x1 0xe 0x8 0x1 0xb 0x8 0x1 0xa 0x8>;
		clock-frequency = <0xc65d40>;
		phandle = <0x68>;
	};

	infracfg_ao@10001000 {
		compatible = "mediatek,infracfg_ao", "syscon";
		reg = <0x0 0x10001000 0x0 0x1000>;
		interrupts = <0x0 0x47 0x1>;
		#clock-cells = <0x1>;
		phandle = <0x21>;
	};

	scpsys@10001000 {
		compatible = "mediatek,scpsys", "syscon";
		reg = <0x0 0x10001000 0x0 0x1000 0x0 0x10006000 0x0 0x1000 0x0 0x14002000 0x0 0x1000 0x0 0x1020e000 0x0 0x1000 0x0 0x18004000 0x0 0x1000 0x0 0x18002000 0x0 0x1000 0x0 0x10000000 0x0 0x1000 0x0 0x16000000 0x0 0x1000 0x0 0x16025000 0x0 0x1000>;
		#clock-cells = <0x1>;
		phandle = <0x22>;
	};

	mcdi@0010fc00 {
		compatible = "mediatek,mt6768-mcdi";
		mediatek,enabled = <0x1>;
		reg = <0x0 0x10fc00 0x0 0x800 0x0 0xc53a000 0x0 0x1000>;
		phandle = <0x69>;
	};

	scp@10500000 {
		compatible = "mediatek,scp";
		status = "okay";
		reg = <0x0 0x10500000 0x0 0x80000 0x0 0x105c0000 0x0 0x3000 0x0 0x105c4000 0x0 0x1000 0x0 0x105d4000 0x0 0x6000>;
		interrupts = <0x0 0xcd 0x4>;
		core_1 = "enable";
		scp_sramSize = <0x80000>;
	};

	scp_dvfs {
		compatible = "mediatek,scp_dvfs";
		clocks = <0x12 0x53 0x13 0x12 0xe 0x12 0x1a 0x12 0x2 0x12 0x17 0x12 0x6 0x12 0x19>;
		clock-names = "clk_mux", "clk_pll_0", "clk_pll_1", "clk_pll_2", "clk_pll_3", "clk_pll_4", "clk_pll_5", "clk_pll_6";
	};

	topckgen@10000000 {
		compatible = "mediatek,topckgen", "syscon";
		reg = <0x0 0x10000000 0x0 0x1000>;
		#clock-cells = <0x1>;
		phandle = <0x12>;
	};

	io_cfg_lt@10002000 {
		compatible = "mediatek,io_cfg_lt";
		reg = <0x0 0x10002000 0x0 0x200>;
		phandle = <0x15>;
	};

	io_cfg_lm@10002200 {
		compatible = "mediatek,io_cfg_lm";
		reg = <0x0 0x10002200 0x0 0x200>;
		phandle = <0x16>;
	};

	io_cfg_lb@10002400 {
		compatible = "mediatek,io_cfg_lb";
		reg = <0x0 0x10002400 0x0 0x200>;
		phandle = <0x17>;
	};

	io_cfg_bl@10002600 {
		compatible = "mediatek,io_cfg_bl";
		reg = <0x0 0x10002600 0x0 0x200>;
		phandle = <0x18>;
	};

	io_cfg_rm@10002800 {
		compatible = "mediatek,io_cfg_rm";
		reg = <0x0 0x10002800 0x0 0x200>;
		phandle = <0x19>;
	};

	io_cfg_rb@10002a00 {
		compatible = "mediatek,io_cfg_rb";
		reg = <0x0 0x10002a00 0x0 0x200>;
		phandle = <0x1a>;
	};

	io_cfg_rt@10002c00 {
		compatible = "mediatek,io_cfg_rt";
		reg = <0x0 0x10002c00 0x0 0x200>;
		phandle = <0x1b>;
	};

	io_cfg_tl@10002e00 {
		compatible = "mediatek,io_cfg_tl";
		reg = <0x0 0x10002e00 0x0 0x200>;
		phandle = <0x1c>;
	};

	pericfg@10003000 {
		compatible = "mediatek,pericfg", "syscon";
		reg = <0x0 0x10003000 0x0 0x1000>;
		#clock-cells = <0x1>;
		phandle = <0x6a>;
	};

	efuse_dbg@10004000 {
		compatible = "mediatek,efuse_dbg";
		reg = <0x0 0x10004000 0x0 0x1000>;
	};

	gpio@10005000 {
		compatible = "mediatek,gpio";
		reg = <0x0 0x10005000 0x0 0x1000>;
		phandle = <0x14>;
	};

	pinctrl {
		compatible = "mediatek,mt6768-pinctrl";
		reg_bases = <0x14 0x15 0x16 0x17 0x18 0x19 0x1a 0x1b 0x1c>;
		reg_base_eint = <0x1d>;
		pins-are-numbered;
		gpio-controller;
		gpio-ranges = <0x1e 0x0 0x0 0xba>;
		#gpio-cells = <0x2>;
		interrupt-controller;
		interrupts = <0x0 0xba 0x4>;
		#interrupt-cells = <0x4>;
		phandle = <0x1e>;

		aud_clk_mosi_off {
			phandle = <0x3e>;

			pins_cmd0_dat {
				pinmux = <0x8800 0x8900>;
			};
		};

		aud_clk_mosi_on {
			phandle = <0x3f>;

			pins_cmd0_dat {
				pinmux = <0x8801>;
				input-schmitt-enable;
			};

			pins_cmd1_dat {
				pinmux = <0x8901>;
				input-schmitt-enable;
			};
		};

		aud_clk_miso_off {
			phandle = <0x40>;

			pins_cmd0_dat {
				pinmux = <0x8c00 0x8d00>;
			};
		};

		aud_clk_miso_on {
			phandle = <0x41>;

			pins_cmd0_dat {
				pinmux = <0x8c01>;
				input-schmitt-enable;
			};

			pins_cmd1_dat {
				pinmux = <0x8d01>;
				input-schmitt-enable;
			};
		};

		aud_dat_mosi_off {
			phandle = <0x42>;

			pins_cmd0_dat {
				pinmux = <0x8800>;
				input-enable;
				slew-rate = <0x0>;
				bias-disable;
			};

			pins_cmd1_dat {
				pinmux = <0x8900>;
				input-enable;
				slew-rate = <0x0>;
				bias-disable;
			};

			pins_cmd2_dat {
				pinmux = <0x8a00>;
				input-enable;
				slew-rate = <0x0>;
				bias-disable;
			};

			pins_cmd3_dat {
				pinmux = <0x8b00>;
				input-enable;
				slew-rate = <0x0>;
				bias-pull-down;
			};
		};

		aud_dat_mosi_on {
			phandle = <0x43>;

			pins_cmd0_dat {
				pinmux = <0x8801>;
				input-schmitt-enable;
			};

			pins_cmd1_dat {
				pinmux = <0x8901>;
				input-schmitt-enable;
			};

			pins_cmd2_dat {
				pinmux = <0x8a01>;
				input-schmitt-enable;
			};

			pins_cmd3_dat {
				pinmux = <0x8b01>;
				input-schmitt-enable;
			};
		};

		aud_dat_miso_off {
			phandle = <0x44>;

			pins_cmd0_dat {
				pinmux = <0x8c00>;
				input-enable;
				slew-rate = <0x0>;
				bias-disable;
			};

			pins_cmd1_dat {
				pinmux = <0x8d00>;
				input-enable;
				slew-rate = <0x0>;
				bias-disable;
			};

			pins_cmd2_dat {
				pinmux = <0x8e00>;
				input-enable;
				slew-rate = <0x0>;
				bias-disable;
			};

			pins_cmd3_dat {
				pinmux = <0x8f00>;
				input-enable;
				slew-rate = <0x0>;
				bias-disable;
			};
		};

		aud_dat_miso_on {
			phandle = <0x45>;

			pins_cmd0_dat {
				pinmux = <0x8c01>;
				input-schmitt-enable;
			};

			pins_cmd1_dat {
				pinmux = <0x8d01>;
				input-schmitt-enable;
			};

			pins_cmd2_dat {
				pinmux = <0x8e01>;
				input-schmitt-enable;
			};

			pins_cmd3_dat {
				pinmux = <0x8f01>;
				input-schmitt-enable;
			};
		};

		aud_gpio_i2s0_off {
			phandle = <0x46>;

			pins_cmd_dat {
				pinmux = <0x2800>;
			};
		};

		aud_gpio_i2s0_on {
			phandle = <0x47>;

			pins_cmd_dat {
				pinmux = <0x2802>;
			};
		};

		aud_gpio_i2s1_off {
			phandle = <0x48>;
		};

		aud_gpio_i2s1_on {
			phandle = <0x49>;
		};

		aud_gpio_i2s2_off {
			phandle = <0x4a>;
		};

		aud_gpio_i2s2_on {
			phandle = <0x4b>;
		};

		aud_gpio_i2s3_off {
			phandle = <0x4c>;

			pins_cmd_dat {
				pinmux = <0x2500 0x2600 0x2400>;
			};
		};

		aud_gpio_i2s3_on {
			phandle = <0x4d>;

			pins_cmd_dat {
				pinmux = <0x2502 0x2602 0x2402>;
			};
		};

		vow_dat_miso_off {
			phandle = <0x4e>;

			pins_cmd1_dat {
				pinmux = <0x8e00>;
			};
		};

		vow_dat_miso_on {
			phandle = <0x4f>;

			pins_cmd1_dat {
				pinmux = <0x8e04>;
			};
		};

		vow_clk_miso_off {
			phandle = <0x50>;

			pins_cmd3_dat {
				pinmux = <0x8f00>;
			};
		};

		vow_clk_miso_on {
			phandle = <0x51>;

			pins_cmd3_dat {
				pinmux = <0x8f04>;
			};
		};

		lcm_power_gpio {
			compatible = "prize,lcm_power_gpio";
			phandle = <0x6b>;
		};

		msdc0@default {
			phandle = <0x30>;

			pins_cmd {
				drive-strength = [03];
			};

			pins_dat {
				drive-strength = [03];
			};

			pins_clk {
				drive-strength = [03];
			};

			pins_rst {
				drive-strength = [03];
			};

			pins_ds {
				drive-strength = [03];
			};
		};

		msdc0@hs400 {
			phandle = <0x31>;

			pins_cmd {
				drive-strength = [03];
			};

			pins_dat {
				drive-strength = [04];
			};

			pins_clk {
				drive-strength = [04];
			};

			pins_rst {
				drive-strength = [03];
			};

			pins_ds {
				drive-strength = [04];
			};
		};

		msdc0@hs200 {
			phandle = <0x32>;

			pins_cmd {
				drive-strength = [03];
			};

			pins_dat {
				drive-strength = [04];
			};

			pins_clk {
				drive-strength = [04];
			};

			pins_rst {
				drive-strength = [03];
			};

			pins_ds {
				drive-strength = [04];
			};
		};

		msdc0@register_default {
			cmd_edge = [00];
			rdata_edge = [00];
			wdata_edge = [00];
			phandle = <0x33>;
		};

		msdc1@default {
			phandle = <0x35>;

			pins_cmd {
				drive-strength = [03];
			};

			pins_dat {
				drive-strength = [03];
			};

			pins_clk {
				drive-strength = [03];
			};
		};

		msdc1@sdr104 {
			phandle = <0x36>;

			pins_cmd {
				drive-strength = [03];
			};

			pins_dat {
				drive-strength = [03];
			};

			pins_clk {
				drive-strength = [03];
			};
		};

		msdc1@sdr50 {
			phandle = <0x37>;

			pins_cmd {
				drive-strength = [03];
			};

			pins_dat {
				drive-strength = [03];
			};

			pins_clk {
				drive-strength = [03];
			};
		};

		msdc1@ddr50 {
			phandle = <0x38>;

			pins_cmd {
				drive-strength = [03];
			};

			pins_dat {
				drive-strength = [03];
			};

			pins_clk {
				drive-strength = [03];
			};
		};

		msdc1@register_default {
			cmd_edge = [00];
			rdata_edge = [00];
			wdata_edge = [00];
			phandle = <0x39>;
		};
	};

	sleep@10006000 {
		compatible = "mediatek,sleep";
		reg = <0x0 0x10006000 0x0 0x1000>;
		interrupts = <0x0 0xc3 0x8>;
		phandle = <0x6c>;
	};

	toprgu@10007000 {
		compatible = "mediatek,toprgu";
		reg = <0x0 0x10007000 0x0 0x1000>;
		interrupts = <0x0 0x9c 0x8>;
		phandle = <0x6d>;
	};

	clocks {

		clk26m {
			compatible = "fixed-clock";
			#clock-cells = <0x0>;
			clock-frequency = <0x18cba80>;
			phandle = <0x13>;
		};

		clk32k {
			compatible = "fixed-clock";
			#clock-cells = <0x0>;
			clock-frequency = <0x7d00>;
			phandle = <0x1f>;
		};
	};

	dcm {
		compatible = "mediatek,dcm";
		phandle = <0x6e>;
	};

	apxgpt@10008000 {
		compatible = "mediatek,apxgpt";
		reg = <0x0 0x10008000 0x0 0x1000>;
		interrupts = <0x0 0xb9 0x8>;
		clocks = <0x1f>;
	};

	hacc@1000a000 {
		compatible = "mediatek,hacc";
		reg = <0x0 0x1000a000 0x0 0x1000>;
		interrupts = <0x0 0xcb 0x8>;
	};

	apirq@1000b000 {
		compatible = "mediatek,apirq";
		reg = <0x0 0x1000b000 0x0 0x1000>;
		interrupts = <0x0 0xba 0x4>;
		phandle = <0x1d>;
	};

	apmixed@1000c000 {
		compatible = "mediatek,apmixed", "syscon";
		reg = <0x0 0x1000c000 0x0 0x1000>;
		#clock-cells = <0x1>;
		phandle = <0x3c>;
	};

	fhctl@1000ce00 {
		compatible = "mediatek,fhctl";
		reg = <0x0 0x1000ce00 0x0 0x200>;
	};

	pwrap@1000d000 {
		compatible = "mediatek,mt6768-pwrap";
		reg = <0x0 0x1000d000 0x0 0x1000>;
		reg-names = "pwrap";
		interrupts = <0x0 0xc2 0x4>;
		clocks = <0x13 0x13>;
		clock-names = "spi", "wrap";
		phandle = <0x20>;

		mt6358-pmic {
			compatible = "mediatek,mt6358-pmic";
			interrupt-parent = <0x1e>;
			interrupts = <0x90 0x4 0x90 0x0>;
			status = "okay";
			interrupt-controller;
			#interrupt-cells = <0x2>;
			mediatek,num-pmic-irqs = <0x91>;
			mediatek,pmic-irqs = <0x0 0x0 0x1 0x0 0x2 0x0 0x3 0x0 0x4 0x0 0x5 0x0 0x6 0x0 0x7 0x0 0x8 0x0 0x9 0x0 0x10 0x1 0x11 0x1 0x12 0x1 0x13 0x1 0x14 0x1 0x15 0x1 0x16 0x1 0x17 0x1 0x18 0x1 0x19 0x1 0x1a 0x1 0x1b 0x1 0x1c 0x1 0x1d 0x1 0x1e 0x1 0x1f 0x1 0x20 0x1 0x21 0x1 0x22 0x1 0x23 0x1 0x24 0x1 0x25 0x1 0x26 0x1 0x27 0x1 0x28 0x1 0x29 0x1 0x2a 0x1 0x2b 0x1 0x2c 0x1 0x2d 0x1 0x2e 0x1 0x30 0x2 0x31 0x2 0x32 0x2 0x33 0x2 0x34 0x2 0x35 0x2 0x36 0x2 0x37 0x2 0x40 0x3 0x50 0x4 0x51 0x4 0x52 0x4 0x53 0x4 0x54 0x4 0x55 0x4 0x56 0x4 0x57 0x4 0x58 0x4 0x59 0x4 0x5a 0x4 0x5b 0x4 0x5c 0x4 0x60 0x4 0x61 0x4 0x62 0x4 0x63 0x4 0x64 0x4 0x70 0x5 0x71 0x5 0x72 0x5 0x73 0x5 0x74 0x5 0x75 0x5 0x76 0x5 0x77 0x5 0x80 0x6 0x85 0x6 0x86 0x6 0x87 0x6 0x90 0x7>;
			interrupt-names = "vproc11_oc", "vproc12_oc", "vcore_oc", "vgpu_oc", "vmodem_oc", "vdram1_oc", "vs1_oc", "vs2_oc", "vpa_oc", "vcore_preoc", "vfe28_oc", "vxo22_oc", "vrf18_oc", "vrf12_oc", "vefuse_oc", "vcn33_oc", "vcn28_oc", "vcn18_oc", "vcama1_oc", "vcama2_oc", "vcamd_oc", "vcamio_oc", "vldo28_oc", "va12_oc", "vaux18_oc", "vaud28_oc", "vio28_oc", "vio18_oc", "vsram_proc11_oc", "vsram_proc12_oc", "vsram_others_oc", "vsram_gpu_oc", "vdram2_oc", "vmc_oc", "vmch_oc", "vemc_oc", "vsim1_oc", "vsim2_oc", "vibr_oc", "vusb_oc", "vbif28_oc", "pwrkey", "homekey", "pwrkey_r", "homekey_r", "ni_lbat_int", "chrdet", "chrdet_edge", "vcdt_hv_det", "rtc", "fg_bat0_h", "fg_bat0_l", "fg_cur_h", "fg_cur_l", "fg_zcv", "fg_bat1_h", "fg_bat1_l", "fg_n_charge_l", "fg_iavg_h", "fg_iavg_l", "fg_time_h", "fg_discharge", "fg_charge", "baton_lv", "baton_ht", "baton_bat_in", "baton_bat_out", "bif", "bat_h", "bat_l", "bat2_h", "bat2_l", "bat_temp_h", "bat_temp_l", "auxadc_imp", "nag_c_dltv", "audio", "accdet", "accdet_eint0", "accdet_eint1", "spi_cmd_alert";
			phandle = <0x6f>;

			mt-pmic {
				compatible = "mediatek,mt-pmic";
				interrupts = <0x30 0x4 0x32 0x4 0x31 0x4 0x33 0x4 0x70 0x4 0x71 0x4 0x52 0x4 0x53 0x4>;
				interrupt-names = "pwrkey", "pwrkey_r", "homekey", "homekey_r", "bat_h", "bat_l", "fg_cur_h", "fg_cur_l";
				phandle = <0x70>;
			};

			mt635x-auxadc {
				compatible = "mediatek,mt6358-auxadc";
				#io-channel-cells = <0x1>;
				phandle = <0x71>;

				batadc {
					channel = <0x0>;
					resistance-ratio = <0x3 0x1>;
					avg-num = <0x80>;
				};

				vcdt {
					channel = <0x2>;
				};

				bat_temp {
					channel = <0x3>;
					resistance-ratio = <0x2 0x1>;
				};

				chip_temp {
					channel = <0x5>;
				};

				vcore_temp {
					channel = <0x6>;
				};

				vproc_temp {
					channel = <0x7>;
				};

				vgpu_temp {
					channel = <0x8>;
				};

				accdet {
					channel = <0x9>;
				};

				dcxo_volt {
					channel = <0xa>;
					resistance-ratio = <0x3 0x2>;
				};

				tsx_temp {
					channel = <0xb>;
					avg-num = <0x80>;
				};

				hpofs_cal {
					channel = <0xc>;
					avg-num = <0x100>;
				};

				dcxo_temp {
					channel = <0xd>;
					avg-num = <0x10>;
				};

				vbif {
					channel = <0xe>;
					resistance-ratio = <0x2 0x1>;
				};
			};

			mt6358regulator {
				compatible = "mediatek,mt6358-regulator";
				phandle = <0x72>;

				buck_vdram1 {
					regulator-name = "vdram1";
					regulator-min-microvolt = <0x7a120>;
					regulator-max-microvolt = <0x1fda4c>;
					regulator-enable-ramp-delay = <0x0>;
					phandle = <0x73>;
				};

				buck_vcore {
					regulator-name = "vcore";
					regulator-min-microvolt = <0x7a120>;
					regulator-max-microvolt = <0x13bdb6>;
					regulator-enable-ramp-delay = <0xc8>;
					phandle = <0x74>;
				};

				buck_vpa {
					regulator-name = "vpa";
					regulator-min-microvolt = <0x7a120>;
					regulator-max-microvolt = <0x37b1d0>;
					regulator-enable-ramp-delay = <0xfa>;
					phandle = <0x75>;
				};

				buck_vproc11 {
					regulator-name = "vproc11";
					regulator-min-microvolt = <0x7a120>;
					regulator-max-microvolt = <0x13bdb6>;
					regulator-enable-ramp-delay = <0xc8>;
					phandle = <0x76>;
				};

				buck_vproc12 {
					regulator-name = "vproc12";
					regulator-min-microvolt = <0x7a120>;
					regulator-max-microvolt = <0x13bdb6>;
					regulator-enable-ramp-delay = <0xc8>;
					phandle = <0x77>;
				};

				buck_vgpu {
					regulator-name = "vgpu";
					regulator-min-microvolt = <0x7a120>;
					regulator-max-microvolt = <0x13bdb6>;
					regulator-enable-ramp-delay = <0xc8>;
					phandle = <0x78>;
				};

				buck_vs2 {
					regulator-name = "vs2";
					regulator-min-microvolt = <0x7a120>;
					regulator-max-microvolt = <0x1fda4c>;
					regulator-enable-ramp-delay = <0x0>;
					phandle = <0x79>;
				};

				buck_vmodem {
					regulator-name = "vmodem";
					regulator-min-microvolt = <0x7a120>;
					regulator-max-microvolt = <0x13bdb6>;
					regulator-enable-ramp-delay = <0x384>;
					phandle = <0x7a>;
				};

				buck_vs1 {
					regulator-name = "vs1";
					regulator-min-microvolt = <0xf4240>;
					regulator-max-microvolt = <0x277b6c>;
					regulator-enable-ramp-delay = <0x0>;
					phandle = <0x7b>;
				};

				ldo_vdram2 {
					regulator-name = "vdram2";
					regulator-min-microvolt = <0x927c0>;
					regulator-max-microvolt = <0x1b7740>;
					regulator-enable-ramp-delay = <0xce4>;
					phandle = <0x7c>;
				};

				ldo_vsim1 {
					regulator-name = "vsim1";
					regulator-min-microvolt = <0x19f0a0>;
					regulator-max-microvolt = <0x2f4d60>;
					regulator-enable-ramp-delay = <0x21c>;
					phandle = <0x7d>;
				};

				ldo_vibr {
					regulator-name = "vibr";
					regulator-min-microvolt = <0x124f80>;
					regulator-max-microvolt = <0x325aa0>;
					regulator-enable-ramp-delay = <0x3c>;
					phandle = <0x7e>;
				};

				ldo_vrf12 {
					compatible = "regulator-fixed";
					regulator-name = "vrf12";
					regulator-min-microvolt = <0x124f80>;
					regulator-max-microvolt = <0x124f80>;
					regulator-enable-ramp-delay = <0x78>;
					phandle = <0x7f>;
				};

				ldo_vio18 {
					compatible = "regulator-fixed";
					regulator-name = "vio18";
					regulator-min-microvolt = <0x1b7740>;
					regulator-max-microvolt = <0x1b7740>;
					regulator-enable-ramp-delay = <0xa8c>;
					phandle = <0x80>;
				};

				ldo_vusb {
					regulator-name = "vusb";
					regulator-min-microvolt = <0x2dc6c0>;
					regulator-max-microvolt = <0x2f4d60>;
					regulator-enable-ramp-delay = <0x10e>;
					phandle = <0x81>;
				};

				ldo_vcamio {
					compatible = "regulator-fixed";
					regulator-name = "vcamio";
					regulator-min-microvolt = <0x1b7740>;
					regulator-max-microvolt = <0x1b7740>;
					regulator-enable-ramp-delay = <0x10e>;
					phandle = <0x82>;
				};

				ldo_vcamd {
					regulator-name = "vcamd";
					regulator-min-microvolt = <0xdbba0>;
					regulator-max-microvolt = <0x1b7740>;
					regulator-enable-ramp-delay = <0x10e>;
					phandle = <0x83>;
				};

				ldo_vcn18 {
					compatible = "regulator-fixed";
					regulator-name = "vcn18";
					regulator-min-microvolt = <0x1b7740>;
					regulator-max-microvolt = <0x1b7740>;
					regulator-enable-ramp-delay = <0x10e>;
					phandle = <0x84>;
				};

				ldo_vfe28 {
					compatible = "regulator-fixed";
					regulator-name = "vfe28";
					regulator-min-microvolt = <0x2ab980>;
					regulator-max-microvolt = <0x2ab980>;
					regulator-enable-ramp-delay = <0x10e>;
					phandle = <0x85>;
				};

				ldo_vsram_proc11 {
					regulator-name = "vsram_proc11";
					regulator-min-microvolt = <0x7a120>;
					regulator-max-microvolt = <0x13bdb6>;
					regulator-enable-ramp-delay = <0xf0>;
					phandle = <0x86>;
				};

				ldo_vcn28 {
					compatible = "regulator-fixed";
					regulator-name = "vcn28";
					regulator-min-microvolt = <0x2ab980>;
					regulator-max-microvolt = <0x2ab980>;
					regulator-enable-ramp-delay = <0x10e>;
					phandle = <0x87>;
				};

				ldo_vsram_others {
					regulator-name = "vsram_others";
					regulator-min-microvolt = <0x7a120>;
					regulator-max-microvolt = <0x13bdb6>;
					regulator-enable-ramp-delay = <0xf0>;
					phandle = <0x88>;
				};

				ldo_vsram_gpu {
					regulator-name = "vsram_gpu";
					regulator-min-microvolt = <0x7a120>;
					regulator-max-microvolt = <0x13bdb6>;
					regulator-enable-ramp-delay = <0xf0>;
					phandle = <0x89>;
				};

				ldo_vxo22 {
					compatible = "regulator-fixed";
					regulator-name = "vxo22";
					regulator-min-microvolt = <0x2191c0>;
					regulator-max-microvolt = <0x2191c0>;
					regulator-enable-ramp-delay = <0x78>;
					phandle = <0x8a>;
				};

				ldo_vefuse {
					regulator-name = "vefuse";
					regulator-min-microvolt = <0x19f0a0>;
					regulator-max-microvolt = <0x1cfde0>;
					regulator-enable-ramp-delay = <0x10e>;
					phandle = <0x8b>;
				};

				ldo_vaux18 {
					compatible = "regulator-fixed";
					regulator-name = "vaux18";
					regulator-min-microvolt = <0x1b7740>;
					regulator-max-microvolt = <0x1b7740>;
					regulator-enable-ramp-delay = <0x10e>;
					phandle = <0x8c>;
				};

				ldo_vmch {
					regulator-name = "vmch";
					regulator-min-microvolt = <0x2c4020>;
					regulator-max-microvolt = <0x325aa0>;
					regulator-enable-ramp-delay = <0x3c>;
					phandle = <0x3a>;
				};

				ldo_vbif28 {
					compatible = "regulator-fixed";
					regulator-name = "vbif28";
					regulator-min-microvolt = <0x2ab980>;
					regulator-max-microvolt = <0x2ab980>;
					regulator-enable-ramp-delay = <0x10e>;
					phandle = <0x8d>;
				};

				ldo_vsram_proc12 {
					regulator-name = "vsram_proc12";
					regulator-min-microvolt = <0x7a120>;
					regulator-max-microvolt = <0x13bdb6>;
					regulator-enable-ramp-delay = <0xf0>;
					phandle = <0x8e>;
				};

				ldo_vcama1 {
					regulator-name = "vcama1";
					regulator-min-microvolt = <0x1b7740>;
					regulator-max-microvolt = <0x2dc6c0>;
					regulator-enable-ramp-delay = <0x10e>;
					phandle = <0x8f>;
				};

				ldo_vemc {
					regulator-name = "vemc";
					regulator-min-microvolt = <0x2c4020>;
					regulator-max-microvolt = <0x325aa0>;
					regulator-enable-ramp-delay = <0x3c>;
					phandle = <0x34>;
				};

				ldo_vio28 {
					compatible = "regulator-fixed";
					regulator-name = "vio28";
					regulator-min-microvolt = <0x2ab980>;
					regulator-max-microvolt = <0x2ab980>;
					regulator-enable-ramp-delay = <0x10e>;
					phandle = <0x90>;
				};

				ldo_va12 {
					compatible = "regulator-fixed";
					regulator-name = "va12";
					regulator-min-microvolt = <0x124f80>;
					regulator-max-microvolt = <0x124f80>;
					regulator-enable-ramp-delay = <0x10e>;
					phandle = <0x91>;
				};

				ldo_vrf18 {
					compatible = "regulator-fixed";
					regulator-name = "vrf18";
					regulator-min-microvolt = <0x1b7740>;
					regulator-max-microvolt = <0x1b7740>;
					regulator-enable-ramp-delay = <0x78>;
					phandle = <0x92>;
				};

				ldo_vcn33_bt {
					regulator-name = "vcn33_bt";
					regulator-min-microvolt = <0x325aa0>;
					regulator-max-microvolt = <0x3567e0>;
					regulator-enable-ramp-delay = <0x10e>;
					phandle = <0x93>;
				};

				ldo_vcn33_wifi {
					regulator-name = "vcn33_wifi";
					regulator-min-microvolt = <0x325aa0>;
					regulator-max-microvolt = <0x3567e0>;
					regulator-enable-ramp-delay = <0x10e>;
					phandle = <0x94>;
				};

				ldo_vcama2 {
					regulator-name = "vcama2";
					regulator-min-microvolt = <0x1b7740>;
					regulator-max-microvolt = <0x2dc6c0>;
					regulator-enable-ramp-delay = <0x10e>;
					phandle = <0x95>;
				};

				ldo_vmc {
					regulator-name = "vmc";
					regulator-min-microvolt = <0x1b7740>;
					regulator-max-microvolt = <0x325aa0>;
					regulator-enable-ramp-delay = <0x3c>;
					phandle = <0x3b>;
				};

				ldo_vldo28 {
					regulator-name = "vldo28";
					regulator-min-microvolt = <0x2ab980>;
					regulator-max-microvolt = <0x2dc6c0>;
					regulator-enable-ramp-delay = <0x10e>;
					phandle = <0x96>;
				};

				ldo_vaud28 {
					compatible = "regulator-fixed";
					regulator-name = "vaud28";
					regulator-min-microvolt = <0x2ab980>;
					regulator-max-microvolt = <0x2ab980>;
					regulator-enable-ramp-delay = <0x10e>;
					phandle = <0x97>;
				};

				ldo_vsim2 {
					regulator-name = "vsim2";
					regulator-min-microvolt = <0x19f0a0>;
					regulator-max-microvolt = <0x2f4d60>;
					regulator-enable-ramp-delay = <0x21c>;
					phandle = <0x98>;
				};

				ldo_va09 {
					compatible = "regulator-fixed";
					regulator-name = "va09";
					regulator-min-microvolt = <0xdbba0>;
					regulator-max-microvolt = <0xdbba0>;
					regulator-enable-ramp-delay = <0x108>;
					regulator-boot-on;
					phandle = <0x99>;
				};
			};

			mt6358_rtc {
				compatible = "mediatek,mt6358-rtc";
				interrupts = <0x40 0x0>;
				interrupt-names = "rtc";
				base = <0x580>;
				apply-lpsd-solution;
				phandle = <0x9a>;
			};

			mt6358_misc {
				compatible = "mediatek,mt6358-misc";
				base = <0x580>;
				apply-lpsd-solution;
				dcxo-switch;
				phandle = <0x9b>;
			};
		};
	};

	pwraphal@ {
		compatible = "mediatek,pwraph";
		mediatek,pwrap-regmap = <0x20>;
		phandle = <0x9c>;
	};

	pwrap_mpu@1000d000 {
		compatible = "mediatek,pwrap_mpu";
		reg = <0x0 0x1000d000 0x0 0x1000>;
	};

	pwrap_p2p@1005cb000 {
		compatible = "mediatek,pwrap_p2p";
		reg = <0x0 0x105cb000 0x0 0x1000>;
	};

	pwrap_md32@10448000 {
		compatible = "mediatek,pwrap_md32";
		reg = <0x0 0x10448000 0x0 0x1000>;
	};

	sleep_reg_md@1000f000 {
		compatible = "mediatek,sleep_reg_md";
		reg = <0x0 0x1000f000 0x0 0x1000>;
	};

	kp@10010000 {
		compatible = "mediatek,kp";
		reg = <0x0 0x10010000 0x0 0x1000>;
		interrupts = <0x0 0x49 0x2>;
		phandle = <0x9d>;
	};

	mrdump_ext_rst {
		compatible = "mediatek, mrdump_ext_rst-eint";
		mode = "IRQ";
		status = "okay";
		phandle = <0x9e>;
	};

	topmisc@10011000 {
		compatible = "mediatek,topmisc";
		reg = <0x0 0x10011000 0x0 0x1000>;
	};

	dvfsrc@10012000 {
		compatible = "mediatek,dvfsrc";
		reg = <0x0 0x10012000 0x0 0x1000 0x0 0x110780 0x0 0x80>;
		phandle = <0x9f>;
	};

	mbist_ao@10013000 {
		compatible = "mediatek,mbist_ao";
		reg = <0x0 0x10013000 0x0 0x1000>;
	};

	apcldmain_ao@10014000 {
		compatible = "mediatek,apcldmain_ao";
		reg = <0x0 0x10014000 0x0 0x400>;
	};

	apcldmaout_ao@10014400 {
		compatible = "mediatek,apcldmaout_ao";
		reg = <0x0 0x10014400 0x0 0x400>;
	};

	apcldmamisc_ao@10014800 {
		compatible = "mediatek,apcldmamisc_ao";
		reg = <0x0 0x10014800 0x0 0x400>;
	};

	apcldmamisc_ao@10014c00 {
		compatible = "mediatek,apcldmamisc_ao";
		reg = <0x0 0x10014c00 0x0 0x400>;
	};

	ddrphy@10015000 {
		compatible = "mediatek,ddrphy";
		reg = <0x0 0x10015000 0x0 0x1000>;
	};

	aes_top0@10016000 {
		compatible = "mediatek,aes_top0";
		reg = <0x0 0x10016000 0x0 0x1000>;
	};

	sys_timer@10017000 {
		compatible = "mediatek,sys_timer";
		reg = <0x0 0x10017000 0x0 0x1000>;
		reg-names = "sys_timer_base";
		interrupts = <0x0 0xcf 0x4>;
		clocks = <0x12 0x86>;
	};

	modem_temp_share@10018000 {
		compatible = "mediatek,modem_temp_share";
		reg = <0x0 0x10018000 0x0 0x1000>;
	};

	security_ao@1001a000 {
		compatible = "mediatek,security_ao";
		reg = <0x0 0x1001a000 0x0 0x1000>;
	};

	topckgen_ao@1001b000 {
		compatible = "mediatek,topckgen_ao";
		reg = <0x0 0x1001b000 0x0 0x1000>;
	};

	iocfg_0@10002000 {
		compatible = "mediatek,iocfg_0";
		reg = <0x0 0x10002000 0x0 0x200>;
	};

	iocfg_1@10002200 {
		compatible = "mediatek,iocfg_1";
		reg = <0x0 0x10002200 0x0 0x200>;
	};

	iocfg_2@10002400 {
		compatible = "mediatek,iocfg_2";
		reg = <0x0 0x10002400 0x0 0x200>;
	};

	iocfg_3@10002600 {
		compatible = "mediatek,iocfg_3";
		reg = <0x0 0x10002600 0x0 0x200>;
	};

	iocfg_4@10002800 {
		compatible = "mediatek,iocfg_4";
		reg = <0x0 0x10002800 0x0 0x200>;
	};

	iocfg_5@10002a00 {
		compatible = "mediatek,iocfg_5";
		reg = <0x0 0x10002a00 0x0 0x200>;
	};

	mdcldmain_ao@10015000 {
		compatible = "mediatek,mdcldmain_ao";
		reg = <0x0 0x10015000 0x0 0x400>;
	};

	mdcldmaout_ao@10015400 {
		compatible = "mediatek,mdcldmaout_ao";
		reg = <0x0 0x10015400 0x0 0x400>;
	};

	mdcldmamisc_ao@10015800 {
		compatible = "mediatek,mdcldmamisc_ao";
		reg = <0x0 0x10015800 0x0 0x400>;
	};

	sys_cirq@10204000 {
		compatible = "mediatek,sys_cirq";
		reg = <0x0 0x10204000 0x0 0x1000>;
		mediatek,cirq_num = <0xe8>;
		mediatek,spi_start_offset = <0x40>;
		interrupts = <0x0 0x127 0x8>;
	};

	mcucfg_mp0_counter@0c530000 {
		compatible = "mediatek,mcucfg_mp0_counter";
		reg = <0x0 0xc530000 0x0 0x10000>;
	};

	mcucfg@0c530000 {
		compatible = "mediatek,mcucfg";
		reg = <0x0 0xc530000 0x0 0x10000>;
		phandle = <0xa0>;
	};

	m4u@10205000 {
		cell-index = <0x0>;
		compatible = "mediatek,m4u";
		reg = <0x0 0x10205000 0x0 0x1000>;
		interrupts = <0x0 0xae 0x8>;
	};

	devapc@10207000 {
		compatible = "mediatek,mt6768-devapc";
		reg = <0x0 0x10207000 0x0 0x1000 0x0 0x1000e000 0x0 0x1000>;
		interrupts = <0x0 0x9f 0x8>;
		clocks = <0x21 0x28>;
		clock-names = "devapc-infra-clock";
	};

	hwrng {
		compatible = "mediatek,mt67xx-rng";
		phandle = <0xa1>;
	};

	bus_dbg@10208000 {
		compatible = "mediatek,bus_dbg-v2";
		reg = <0x0 0x10208000 0x0 0x1000 0x0 0x10001000 0x0 0x1000>;
		mediatek,bus_dbg_con_offset = <0x2fc>;
		interrupts = <0x0 0x9e 0x8>;
	};

	ap_ccif0@10209000 {
		compatible = "mediatek,ap_ccif0";
		reg = <0x0 0x10209000 0x0 0x1000>;
		interrupts = <0x0 0xa4 0x8>;
	};

	md_ccif0@1020a000 {
		compatible = "mediatek,md_ccif0";
		reg = <0x0 0x1020a000 0x0 0x1000>;
	};

	ap_ccif1@1020b000 {
		compatible = "mediatek,ap_ccif1";
		reg = <0x0 0x1020b000 0x0 0x1000>;
		interrupts = <0x0 0xa6 0x8>;
	};

	md_ccif1@1020c000 {
		compatible = "mediatek,md_ccif1";
		reg = <0x0 0x1020c000 0x0 0x1000>;
	};

	infra_mbist@1020d000 {
		compatible = "mediatek,infra_mbist";
		reg = <0x0 0x1020d000 0x0 0x1000>;
	};

	infracfg@1020e000 {
		compatible = "mediatek,infracfg";
		reg = <0x0 0x1020e000 0x0 0x1000>;
	};

	trng@1020f000 {
		compatible = "mediatek,trng";
		reg = <0x0 0x1020f000 0x0 0x1000>;
		interrupts = <0x0 0xb0 0x8>;
	};

	dxcc_sec@10210000 {
		compatible = "mediatek,dxcc_sec";
		reg = <0x0 0x10210000 0x0 0x1000>;
		interrupts = <0x0 0xb1 0x4>;
	};

	mcupm_sram2@10211000 {
		compatible = "mediatek,mcupm_sram2";
		reg = <0x0 0x10211000 0x0 0x1000>;
	};

	cq_dma@10212000 {
		compatible = "mediatek,mt-cqdma-v1";
		reg = <0x0 0x10212000 0x0 0x80 0x0 0x10212080 0x0 0x80 0x0 0x10212100 0x0 0x80>;
		interrupts = <0x0 0x86 0x8 0x0 0x87 0x8 0x0 0x88 0x8>;
		nr_channel = <0x3>;
		clocks = <0x21 0x43>;
		clock-names = "cqdma";
	};

	mcupm_sram3@10213000 {
		compatible = "mediatek,mcupm_sram3";
		reg = <0x0 0x10213000 0x0 0x1000>;
	};

	sramrom@10214000 {
		compatible = "mediatek,sramrom";
		reg = <0x0 0x10214000 0x0 0x1000>;
	};

	mcupm_reg@10216000 {
		compatible = "mediatek,mcupm_reg";
		reg = <0x0 0x10216000 0x0 0x1000>;
	};

	mcupm_sram0@10217000 {
		compatible = "mediatek,mcupm_sram0";
		reg = <0x0 0x10217000 0x0 0x1000>;
	};

	mcupm_sram1@10218000 {
		compatible = "mediatek,mcupm_sram1";
		reg = <0x0 0x10218000 0x0 0x1000>;
	};

	emi@10219000 {
		compatible = "mediatek,emi";
		reg = <0x0 0x10219000 0x0 0x1000 0x0 0x10226000 0x0 0x1000 0x0 0x1022d000 0x0 0x1000 0x0 0x10235000 0x0 0x1000 0x0 0x1020e000 0x0 0x1000>;
		interrupts = <0x0 0xa1 0x8>;
	};

	chn_emi@1021a000 {
		compatible = "mediatek,chn_emi";
		reg = <0x0 0x1021a000 0x0 0x1000>;
	};

	apcldmain@1021b000 {
		compatible = "mediatek,apcldmain";
		reg = <0x0 0x1021b000 0x0 0x100>;
	};

	apcldmain@1021b100 {
		compatible = "mediatek,apcldmain";
		reg = <0x0 0x1021b100 0x0 0x100>;
	};

	apcldmaout@1021b400 {
		compatible = "mediatek,apcldmaout";
		reg = <0x0 0x1021b400 0x0 0x100>;
	};

	apcldmaout@1021b500 {
		compatible = "mediatek,apcldmaout";
		reg = <0x0 0x1021b500 0x0 0x100>;
	};

	apcldmamisc@1021b800 {
		compatible = "mediatek,apcldmamisc";
		reg = <0x0 0x1021b800 0x0 0x100>;
		interrupts = <0x0 0xb4 0x4>;
	};

	apcldmamisc@1021b900 {
		compatible = "mediatek,apcldmamisc";
		reg = <0x0 0x1021b900 0x0 0x400>;
	};

	mdcldmain@1021c000 {
		compatible = "mediatek,mdcldmain";
		reg = <0x0 0x1021c000 0x0 0x400>;
	};

	mdcldmaout@1021c400 {
		compatible = "mediatek,mdcldmaout";
		reg = <0x0 0x1021c400 0x0 0x400>;
	};

	mdcldmamisc@1021c000 {
		compatible = "mediatek,mdcldmamisc";
		reg = <0x0 0x1021c000 0x0 0x1000>;
	};

	mdcldmamisc@1021c900 {
		compatible = "mediatek,mdcldmamisc";
		reg = <0x0 0x1021c900 0x0 0x400>;
	};

	mdcldma@10014000 {
		compatible = "mediatek,mdcldma";
		reg = <0x0 0x10014000 0x0 0x1000 0x0 0x1021b000 0x0 0x1000 0x0 0x10209000 0x0 0x1000 0x0 0x1020a000 0x0 0x1000>;
		interrupts = <0x0 0xb4 0x4 0x0 0xa4 0x8 0x0 0xa5 0x8 0x0 0x4b 0x2>;
		mediatek,md_id = <0x0>;
		mediatek,cldma_capability = <0x6>;
		clocks = <0x22 0x0 0x21 0x32 0x21 0x29 0x21 0x2c 0x21 0x23 0x21 0x24 0x21 0x51 0x21 0x52>;
		clock-names = "scp-sys-md1-main", "infra-cldma-bclk", "infra-ccif-ap", "infra-ccif-md", "infra-ccif1-ap", "infra-ccif1-md", "infra-ccif2-ap", "infra-ccif2-md";
		phandle = <0xa2>;
	};

	md_auxadc {
		compatible = "mediatek,md_auxadc";
		io-channels = <0x23 0x2>;
		io-channel-names = "md-channel";
		phandle = <0xa3>;
	};

	bpi_bsi_slv0@1021e000 {
		compatible = "mediatek,bpi_bsi_slv0";
		reg = <0x0 0x1021e000 0x0 0x1000>;
	};

	bpi_bsi_slv1@1021f000 {
		compatible = "mediatek,bpi_bsi_slv1";
		reg = <0x0 0x1021f000 0x0 0x6000>;
	};

	bpi_bsi_slv2@10225000 {
		compatible = "mediatek,bpi_bsi_slv2";
		reg = <0x0 0x10225000 0x0 0x1000>;
	};

	emi_mpu@10226000 {
		compatible = "mediatek,emi_mpu";
		reg = <0x0 0x10226000 0x0 0x1000>;
	};

	dvfsp@10227000 {
		compatible = "mediatek,dvfsp";
		reg = <0x0 0x10227000 0x0 0x1000>;
	};

	dvfsp@00110800 {
		compatible = "mediatek,mt6768-dvfsp";
		reg = <0x0 0x110800 0x0 0x1400 0x0 0x110800 0x0 0x1400>;
		state = <0x1>;
		change_flag = <0x0>;
		little-rise-time = <0x3e8>;
		little-down-time = <0x2ee>;
		big-rise-time = <0x3e8>;
		big-down-time = <0x2ee>;
		L-table = <0x6a4 0x38 0x2 0x1 0x659 0x35 0x2 0x1 0x5dc 0x30 0x2 0x1 0x5aa 0x2e 0x2 0x1 0x55f 0x2b 0x2 0x1 0x52d 0x29 0x2 0x1 0x4fb 0x27 0x2 0x1 0x497 0x22 0x2 0x1 0x44c 0x29 0x2 0x1 0x41a 0x1d 0x2 0x1 0x3e7 0x1b 0x2 0x1 0x3b6 0x19 0x2 0x1 0x384 0x17 0x2 0x1 0x352 0x15 0x4 0x1 0x306 0x13 0x4 0x1 0x1f4 0x10 0x4 0x1>;
		B-table = <0x7d0 0x48 0x1 0x1 0x79e 0x45 0x1 0x1 0x76c 0x41 0x1 0x1 0x73a 0x3d 0x1 0x1 0x708 0x3a 0x1 0x1 0x6ae 0x36 0x1 0x1 0x655 0x32 0x1 0x1 0x60c 0x30 0x2 0x1 0x5a3 0x2b 0x2 0x1 0x54a 0x27 0x2 0x1 0x4f1 0x24 0x2 0x1 0x498 0x20 0x2 0x1 0x43f 0x1d 0x2 0x1 0x3e6 0x19 0x2 0x1 0x38d 0x16 0x2 0x1 0x352 0x13 0x2 0x1>;
		CCI-table = <0x4a3 0x38 0x2 0x1 0x460 0x34 0x2 0x1 0x419 0x30 0x2 0x1 0x3f6 0x2e 0x2 0x1 0x3c1 0x2b 0x2 0x1 0x38d 0x28 0x2 0x1 0x358 0x24 0x2 0x1 0x335 0x22 0x2 0x1 0x300 0x1f 0x2 0x1 0x2dd 0x1d 0x4 0x1 0x2ba 0x1b 0x4 0x1 0x297 0x19 0x4 0x1 0x274 0x17 0x4 0x1 0x251 0x15 0x4 0x1 0x3a 0x13 0x4 0x1 0x1f4 0x10 0x4 0x1>;
		phandle = <0xa4>;
	};

	mt_cpufreq {
		compatible = "mediatek,mt-cpufreq";
		phandle = <0xa5>;
	};

	dramc@1022a000 {
		compatible = "mediatek,dramc";
		reg = <0x0 0x1022a000 0x0 0x2000 0x0 0x10232000 0x0 0x2000 0x0 0x1022c000 0x0 0x1000 0x0 0x10234000 0x0 0x1000 0x0 0x10228000 0x0 0x2000 0x0 0x10230000 0x0 0x2000 0x0 0x1022e000 0x0 0x1000 0x0 0x10236000 0x0 0x1000>;
	};

	gce@10238000 {
		compatible = "mediatek,gce", "syscon";
		reg = <0x0 0x10238000 0x0 0x4000>;
		#clock-cells = <0x1>;
		interrupts = <0x0 0xaa 0x8>;
		disp_mutex_reg = <0x14016000 0x1000>;
		g3d_config_base = <0x13000000 0x0 0xffff0000>;
		mmsys_config_base = <0x14000000 0x1 0xffff0000>;
		disp_dither_base = <0x14010000 0x2 0xffff0000>;
		mm_na_base = <0x14020000 0x3 0xffff0000>;
		imgsys_base = <0x15020000 0x4 0xffff0000>;
		vdec_gcon_base = <0x18800000 0x5 0xffff0000>;
		venc_gcon_base = <0x18810000 0x6 0xffff0000>;
		conn_peri_base = <0x18820000 0x7 0xffff0000>;
		topckgen_base = <0x18830000 0x8 0xffff0000>;
		kp_base = <0x18840000 0x9 0xffff0000>;
		scp_sram_base = <0x10000000 0xa 0xffff0000>;
		infra_na3_base = <0x10010000 0xb 0xffff0000>;
		infra_na4_base = <0x10020000 0xc 0xffff0000>;
		scp_base = <0x10030000 0xd 0xffff0000>;
		mcucfg_base = <0x10040000 0xe 0xffff0000>;
		gcpu_base = <0x10050000 0xf 0xffff0000>;
		usb0_base = <0x10200000 0x10 0xffff0000>;
		usb_sif_base = <0x10280000 0x11 0xffff0000>;
		audio_base = <0x17000000 0x12 0xffff0000>;
		vdec_base = <0x17010000 0x13 0xffff0000>;
		msdc2_base = <0x17020000 0x14 0xffff0000>;
		vdec1_base = <0x17030000 0x15 0xffff0000>;
		msdc3_base = <0x18000000 0x16 0xffff0000>;
		ap_dma_base = <0x18010000 0x17 0xffff0000>;
		gce_base = <0x18020000 0x18 0xffff0000>;
		vdec2_base = <0x18040000 0x19 0xffff0000>;
		vdec3_base = <0x18050000 0x1a 0xffff0000>;
		camsys_base = <0x18080000 0x1b 0xffff0000>;
		camsys1_base = <0x180a0000 0x1c 0xffff0000>;
		camsys2_base = <0x180b0000 0x1d 0xffff0000>;
		pwm_sw_base = <0x1100e000 0x63 0xffff0000>;
		mdp_rdma0_sof = <0x0>;
		mdp_ccorr0_sof = <0x1>;
		mdp_rsz0_sof = <0x2>;
		mdp_rsz1_sof = <0x3>;
		mdp_wdma_sof = <0x4>;
		mdp_wrot0_sof = <0x5>;
		mdp_tdshp0_sof = <0x6>;
		disp_ovl0_sof = <0x7>;
		disp_2l_ovl0_sof = <0x8>;
		disp_rdma0_sof = <0x9>;
		disp_wdma0_sof = <0xa>;
		disp_color0_sof = <0xb>;
		disp_ccorr0_sof = <0xc>;
		disp_aal0_sof = <0xd>;
		disp_gamma0_sof = <0xe>;
		disp_dither0_sof = <0xf>;
		disp_dsi0_sof = <0x10>;
		disp_rsz0_sof = <0x11>;
		img_dl_relay_sof = <0x12>;
		disp_pwm0_sof = <0x13>;
		mdp_rdma0_frame_done = <0x14>;
		mdp_ccorr0_frame_done = <0x15>;
		mdp_rsz0_frame_done = <0x16>;
		mdp_rsz1_frame_done = <0x17>;
		mdp_wrot0_write_frame_done = <0x18>;
		mdp_wdma_frame_done = <0x19>;
		mdp_tdshp0_frame_done = <0x1a>;
		disp_ovl0_frame_done = <0x1b>;
		disp_2l_ovl0_frame_done = <0x1c>;
		disp_rsz0_frame_done = <0x1d>;
		disp_rdma0_frame_done = <0x1e>;
		disp_wdma0_frame_done = <0x1f>;
		disp_color0_frame_done = <0x20>;
		disp_ccorr0_frame_done = <0x21>;
		disp_aal0_frame_done = <0x22>;
		disp_gamma0_frame_done = <0x23>;
		disp_dither0_frame_done = <0x24>;
		disp_dsi0_frame_done = <0x25>;
		stream_done_0 = <0x82>;
		stream_done_1 = <0x83>;
		stream_done_2 = <0x84>;
		stream_done_3 = <0x85>;
		stream_done_4 = <0x86>;
		stream_done_5 = <0x87>;
		stream_done_6 = <0x88>;
		stream_done_7 = <0x89>;
		stream_done_8 = <0x8a>;
		stream_done_9 = <0x8b>;
		buf_underrun_event_0 = <0x8c>;
		dsi0_te_event = <0x8d>;
		dsi0_irq_event = <0x8e>;
		dsi0_done_event = <0x8f>;
		disp_wdma0_rst_done = <0x93>;
		mdp_wdma_rst_done = <0x94>;
		mdp_wrot0_rst_done = <0x95>;
		mdp_rdma0_rst_done = <0x97>;
		disp_ovl0_frame_rst_done_pusle = <0x98>;
		dip_cq_thread0_frame_done = <0x101>;
		dip_cq_thread1_frame_done = <0x102>;
		dip_cq_thread2_frame_done = <0x103>;
		dip_cq_thread3_frame_done = <0x104>;
		dip_cq_thread4_frame_done = <0x105>;
		dip_cq_thread5_frame_done = <0x106>;
		dip_cq_thread6_frame_done = <0x107>;
		dip_cq_thread7_frame_done = <0x108>;
		dip_cq_thread8_frame_done = <0x109>;
		dip_cq_thread9_frame_done = <0x10a>;
		dip_cq_thread10_frame_done = <0x10b>;
		dip_cq_thread11_frame_done = <0x10c>;
		dip_cq_thread12_frame_done = <0x10d>;
		dip_cq_thread13_frame_done = <0x10e>;
		dip_cq_thread14_frame_done = <0x10f>;
		dip_cq_thread15_frame_done = <0x110>;
		dip_cq_thread16_frame_done = <0x111>;
		dip_cq_thread17_frame_done = <0x112>;
		dip_cq_thread18_frame_done = <0x113>;
		dve_frame_done = <0x114>;
		wmf_frame_done = <0x115>;
		rsc_frame_done = <0x116>;
		venc_frame_done = <0x121>;
		venc_pause_done = <0x122>;
		jpgenc_done = <0x123>;
		venc_mb_done = <0x124>;
		venc_128byte_cnt_done = <0x125>;
		isp_frame_done_b = <0x142>;
		camsv_0_pass1_done = <0x143>;
		camsv_1_pass1_done = <0x144>;
		camsv_2_pass1_done = <0x145>;
		tsf_done = <0x146>;
		seninf_0_fifo_full = <0x147>;
		seninf_1_fifo_full = <0x148>;
		seninf_2_fifo_full = <0x149>;
		seninf_3_fifo_full = <0x14a>;
		seninf_4_fifo_full = <0x14b>;
		seninf_5_fifo_full = <0x14c>;
		seninf_6_fifo_full = <0x14d>;
		seninf_7_fifo_full = <0x14e>;
		dsi0_te_from_infra = <0x382>;
		mmsys_config = <0x24>;
		mdp_rdma0 = <0x25>;
		mdp_rsz0 = <0x26>;
		mdp_rsz1 = <0x27>;
		mdp_wdma0 = <0x28>;
		mdp_wrot0 = <0x29>;
		mdp_tdshp0 = <0x2a>;
		mdp_color0 = <0x2b>;
		mdp_ccorr0 = <0x2c>;
		mm_mutex = <0x2d>;
		sram_share_cnt = <0x1>;
		sram_share_engine = <0xd>;
		sram_share_event = <0x2c6>;
		mediatek,mailbox-gce = <0x2e>;
		secure_thread = <0x6 0x8>;
		mboxes = <0x2e 0x0 0x0 0x4 0x2e 0x2 0x0 0x5 0x2e 0x3 0x0 0x4 0x2e 0x4 0x0 0x4 0x2e 0x6 0x0 0x3 0x2e 0x7 0xffffffff 0x2 0x2e 0x8 0x0 0x1 0x2e 0x9 0x0 0x1 0x2e 0xa 0x0 0x1 0x2e 0xb 0x0 0x1 0x2e 0xc 0x0 0x1 0x2e 0xd 0x0 0x1 0x2e 0xe 0x0 0x1 0x2e 0xf 0xffffffff 0x1>;
		clocks = <0x21 0x9 0x21 0x18 0x22 0x3>;
		clock-names = "GCE", "GCE_TIMER", "MMSYS_MTCMOS";
		phandle = <0xa6>;
	};

	gce_mbox@10238000 {
		compatible = "mediatek,mailbox-gce";
		reg = <0x0 0x10238000 0x0 0x4000>;
		interrupts = <0x0 0xaa 0x8>;
		clocks = <0x21 0x9 0x21 0x18>;
		clock-names = "gce", "gce-timer";
		#mbox-cells = <0x3>;
		#gce-event-cells = <0x1>;
		#gce-subsys-cells = <0x2>;
		phandle = <0x2e>;
	};

	ap_ccif2@1023c000 {
		compatible = "mediatek,ap_ccif2";
		reg = <0x0 0x1023c000 0x0 0x1000>;
		interrupts = <0x0 0xa0 0x8>;
	};

	md_ccif2@1023d000 {
		compatible = "mediatek,md_ccif2";
		reg = <0x0 0x1023d000 0x0 0x1000>;
	};

	ap_ccif3@1023e000 {
		compatible = "mediatek,ap_ccif3";
		reg = <0x0 0x1023e000 0x0 0x1000>;
		interrupts = <0x0 0xa3 0x8>;
	};

	fingerprint {
		compatible = "mediatek,goodix-fp";
		phandle = <0xa7>;
	};

	fpc {
		compatible = "mediatek,mt6765-fpc";
		phandle = <0xa8>;
	};

	accdet {
		compatible = "mediatek,pmic-accdet";
		phandle = <0xa9>;
	};

	mt6358_gauge {
		compatible = "mediatek,mt6358_gauge";
		gauge_name = "gauge";
		alias_name = "MT6358";
	};

	gauge_timer {
		compatible = "mediatek,gauge_timer_service";
	};

	battery {
		compatible = "mediatek,bat_gm30";
		DIFFERENCE_FULLOCV_ITH = <0xc8>;
		SHUTDOWN_1_TIME = <0x1e>;
		KEEP_100_PERCENT = <0x1>;
		R_FG_VALUE = <0xa>;
		EMBEDDED_SEL = <0x0>;
		PMIC_SHUTDOWN_CURRENT = <0x14>;
		FG_METER_RESISTANCE = <0x64>;
		CAR_TUNE_VALUE = <0x64>;
		PMIC_MIN_VOL = <0x82dc>;
		POWERON_SYSTEM_IBOOT = <0x1f4>;
		SHUTDOWN_GAUGE0_VOLTAGE = <0x84d0>;
		TEMPERATURE_T0 = <0x32>;
		TEMPERATURE_T1 = <0x19>;
		TEMPERATURE_T2 = <0xa>;
		TEMPERATURE_T3 = <0x0>;
		TEMPERATURE_T4 = <0xfffffffa>;
		TEMPERATURE_T5 = <0xfffffff6>;
		g_FG_PSEUDO100_T0 = <0x64>;
		g_FG_PSEUDO100_T1 = <0x64>;
		g_FG_PSEUDO100_T2 = <0x64>;
		g_FG_PSEUDO100_T3 = <0x64>;
		g_FG_PSEUDO100_T4 = <0x64>;
		Q_MAX_SYS_VOLTAGE_BAT0 = <0xd16>;
		Q_MAX_SYS_VOLTAGE_BAT1 = <0xd16>;
		Q_MAX_SYS_VOLTAGE_BAT2 = <0xd16>;
		Q_MAX_SYS_VOLTAGE_BAT3 = <0xd16>;
		COM_FG_METER_RESISTANCE = <0x64>;
		COM_R_FG_VALUE = <0x0>;
		enable_tmp_intr_suspend = <0x0>;
		ACTIVE_TABLE = <0x6>;
		MULTI_TEMP_GAUGE0 = <0x1>;
		battery0_profile_t0_num = <0x64>;
		battery0_profile_t0_col = <0x3>;
		battery0_profile_t0 = <0x0 0xa910 0x3cf 0x12d 0xa8a2 0x3cf 0x259 0xa82a 0x401 0x386 0xa7b1 0x3e8 0x4b2 0xa743 0x3cf 0x5df 0xa6c1 0x3b6 0x70c 0xa653 0x3d0 0x838 0xa5ee 0x419 0x965 0xa56c 0x3d0 0xa91 0xa508 0x401 0xbbe 0xa4a4 0x41a 0xceb 0xa435 0x419 0xe17 0xa3bd 0x402 0xf44 0xa34f 0x41a 0x1070 0xa2eb 0x41a 0x119d 0xa273 0x41a 0x12ca 0xa20b 0x41c 0x13f6 0xa19e 0x433 0x1523 0xa142 0x433 0x1650 0xa0d4 0x433 0x177c 0xa067 0x431 0x18a9 0xa003 0x41c 0x19d5 0x9fa7 0x433 0x1b02 0x9f2f 0x431 0x1c2f 0x9ec3 0x424 0x1d5b 0x9e73 0x499 0x1e88 0x9e22 0x4ac 0x1fb4 0x9dc7 0x47e 0x20e1 0x9d64 0x47a 0x220e 0x9d0b 0x453 0x233a 0x9cba 0x497 0x2467 0x9c68 0x495 0x2593 0x9c06 0x480 0x26c0 0x9bb6 0x497 0x27ed 0x9b66 0x49f 0x2919 0x9b15 0x4dd 0x2a46 0x9abc 0x4b5 0x2b72 0x9a6a 0x4e2 0x2c9f 0x9a0c 0x4da 0x2dcc 0x998c 0x494 0x2ef8 0x991c 0x478 0x3025 0x98a5 0x446 0x3151 0x983c 0x41d 0x327e 0x97f3 0x42a 0x33ab 0x979e 0x3eb 0x34d7 0x9769 0x401 0x3604 0x9723 0x3fe 0x3730 0x96e1 0x3ef 0x385d 0x96b4 0x412 0x398a 0x967b 0x3f0 0x3ab6 0x9653 0x41e 0x3be3 0x9628 0x42f 0x3d10 0x95ed 0x416 0x3e3c 0x95bf 0x40a 0x3f69 0x959b 0x449 0x4095 0x9563 0x491 0x41c2 0x953d 0x405 0x42ef 0x951f 0x423 0x441b 0x94ff 0x447 0x4548 0x94d7 0x43c 0x4674 0x94ab 0x457 0x47a1 0x9478 0x445 0x48ce 0x946c 0x4e8 0x49fa 0x9450 0x484 0x4b27 0x9420 0x447 0x4c53 0x9416 0x48d 0x4d80 0x93e8 0x465 0x4ead 0x93c8 0x46a 0x4fd9 0x939a 0x46f 0x5106 0x9352 0x429 0x5232 0x9306 0x401 0x535f 0x92ce 0x406 0x548c 0x92a3 0x41a 0x55b8 0x9271 0x40f 0x56e5 0x9241 0x3f3 0x5811 0x9219 0x435 0x593e 0x91f1 0x476 0x5a6b 0x91cb 0x401 0x5b97 0x91af 0x40d 0x5cc4 0x9190 0x42d 0x5df0 0x9152 0x413 0x5f1d 0x9109 0x3fa 0x604a 0x90c6 0x424 0x6176 0x90a5 0x4a1 0x62a3 0x9068 0x433 0x63d0 0x9002 0x42c 0x64fc 0x8fd6 0x405 0x6629 0x8fbd 0x3dd 0x6755 0x8fb9 0x401 0x6882 0x8fbd 0x40f 0x69af 0x8fb3 0x448 0x6adb 0x8fa6 0x49a 0x6c08 0x8f81 0x4d4 0x6d34 0x8f00 0x49a 0x6e61 0x8dd1 0x45e 0x6f8e 0x8c08 0x45b 0x70ba 0x89c7 0x47e 0x71e7 0x869b 0x4a3 0x7313 0x8143 0x600 0x7440 0x72ec 0x2198>;
		battery0_profile_t1_num = <0x64>;
		battery0_profile_t1_col = <0x3>;
		battery0_profile_t1 = <0x0 0xa8c0 0x41a 0x12d 0xa848 0x514 0x259 0xa7d0 0x546 0x386 0xa757 0x514 0x4b2 0xa6df 0x52d 0x5df 0xa67b 0x546 0x70c 0xa60d 0x55f 0x838 0xa594 0x579 0x965 0xa526 0x5aa 0xa91 0xa4b8 0x5aa 0xbbe 0xa453 0x5c2 0xceb 0xa3d2 0x5a9 0xe17 0xa36d 0x590 0xf44 0xa2ff 0x578 0x1070 0xa291 0x579 0x119d 0xa237 0x5aa 0x12ca 0xa1c5 0x5a8 0x13f6 0xa161 0x591 0x1523 0xa0fc 0x593 0x1650 0xa085 0x5a8 0x177c 0xa021 0x595 0x18a9 0x9fbd 0x5c3 0x19d5 0x9f63 0x5c3 0x1b02 0x9f0c 0x5c9 0x1c2f 0x9ed9 0x60e 0x1d5b 0x9e97 0x60e 0x1e88 0x9e11 0x605 0x1fb4 0x9d61 0x5ae 0x20e1 0x9cdf 0x5de 0x220e 0x9c6b 0x5f5 0x233a 0x9c1c 0x5fa 0x2467 0x9be1 0x635 0x2593 0x9bae 0x6b8 0x26c0 0x9b70 0x686 0x27ed 0x9b20 0x659 0x2919 0x9acc 0x651 0x2a46 0x9a55 0x60e 0x2b72 0x99f0 0x609 0x2c9f 0x9981 0x5d9 0x2dcc 0x9909 0x5c0 0x2ef8 0x9894 0x5a7 0x3025 0x983a 0x58b 0x3151 0x97e4 0x565 0x327e 0x97ae 0x585 0x33ab 0x9762 0x530 0x34d7 0x972f 0x546 0x3604 0x96f4 0x546 0x3730 0x96bf 0x53c 0x385d 0x967b 0x4ff 0x398a 0x9653 0x51c 0x3ab6 0x9626 0x53e 0x3be3 0x95e9 0x521 0x3d10 0x95d3 0x55b 0x3e3c 0x95b1 0x54a 0x3f69 0x957f 0x55b 0x4095 0x9551 0x54a 0x41c2 0x9531 0x556 0x42ef 0x950b 0x536 0x441b 0x94ec 0x564 0x4548 0x94ce 0x57d 0x4674 0x94ae 0x591 0x47a1 0x9486 0x588 0x48ce 0x9464 0x56d 0x49fa 0x9454 0x5aa 0x4b27 0x942e 0x5aa 0x4c53 0x9410 0x5aa 0x4d80 0x93ee 0x5a0 0x4ead 0x93c0 0x56e 0x4fd9 0x93a0 0x54b 0x5106 0x9378 0x55f 0x5232 0x9350 0x564 0x535f 0x9328 0x578 0x548c 0x92fd 0x578 0x55b8 0x92d0 0x573 0x56e5 0x92b2 0x56a 0x5811 0x9293 0x591 0x593e 0x9273 0x58b 0x5a6b 0x924d 0x57e 0x5b97 0x922a 0x585 0x5cc4 0x91f4 0x565 0x5df0 0x91b8 0x56b 0x5f1d 0x9177 0x539 0x604a 0x9134 0x528 0x6176 0x9109 0x558 0x62a3 0x90b8 0x53f 0x63d0 0x9076 0x526 0x64fc 0x9060 0x529 0x6629 0x905d 0x566 0x6755 0x904e 0x571 0x6882 0x9038 0x574 0x69af 0x902d 0x5aa 0x6adb 0x8fff 0x5bf 0x6c08 0x8f87 0x5e0 0x6d34 0x8e47 0x5b1 0x6e61 0x8c6f 0x5d9 0x6f8e 0x8a0d 0x62b 0x70ba 0x86ab 0x6c3 0x71e7 0x8045 0x1451 0x7313 0x6e34 0x1665 0x7440 0x6e14 0x15f9>;
		battery0_profile_t2_num = <0x64>;
		battery0_profile_t2_col = <0x3>;
		battery0_profile_t2 = <0x0 0xa816 0x76c 0x12d 0xa780 0x834 0x259 0xa712 0x898 0x386 0xa699 0x8b1 0x4b2 0xa617 0x898 0x5df 0xa5a9 0x8b1 0x70c 0xa53b 0x8b1 0x838 0xa4c3 0x8b1 0x965 0xa45e 0x8ca 0xa91 0xa3fa 0x8ca 0xbbe 0xa38c 0x8e3 0xceb 0xa314 0x8e4 0xe17 0xa2b0 0x8fd 0xf44 0xa255 0x915 0x1070 0xa1e7 0x916 0x119d 0xa179 0x92f 0x12ca 0xa111 0x947 0x13f6 0xa0a3 0x947 0x1523 0xa03f 0x947 0x1650 0x9fdd 0x949 0x177c 0x9f98 0x964 0x18a9 0x9f5c 0x99a 0x19d5 0x9f26 0x9f6 0x1b02 0x9ebf 0x9f2 0x1c2f 0x9e2e 0x9c2 0x1d5b 0x9d73 0x9ab 0x1e88 0x9cd6 0x9af 0x1fb4 0x9c5d 0x9db 0x20e1 0x9be9 0x9c8 0x220e 0x9b9b 0x9fb 0x233a 0x9b69 0xa26 0x2467 0x9b35 0xa11 0x2593 0x9af1 0xa28 0x26c0 0x9aba 0xa26 0x27ed 0x9a56 0xa07 0x2919 0x99f0 0x9bc 0x2a46 0x9977 0x96e 0x2b72 0x9900 0x910 0x2c9f 0x9894 0x8e0 0x2dcc 0x983c 0x8cd 0x2ef8 0x97f4 0x8da 0x3025 0x979d 0x89b 0x3151 0x9762 0x8b4 0x327e 0x972c 0x8c1 0x33ab 0x96e1 0x885 0x34d7 0x96b7 0x8b1 0x3604 0x967d 0x8b7 0x3730 0x9655 0x8e6 0x385d 0x962a 0x8f4 0x398a 0x95f8 0x8c2 0x3ab6 0x95c9 0x8a9 0x3be3 0x95a9 0x8fc 0x3d10 0x957e 0x8f3 0x3e3c 0x9547 0x8d3 0x3f69 0x952a 0x905 0x4095 0x9513 0x92a 0x41c2 0x94ed 0x915 0x42ef 0x94cd 0x915 0x441b 0x94a6 0x91a 0x4548 0x9488 0x929 0x4674 0x946a 0x91e 0x47a1 0x944e 0x947 0x48ce 0x9436 0x94c 0x49fa 0x9412 0x95b 0x4b27 0x93fc 0x947 0x4c53 0x93e2 0x951 0x4d80 0x93d0 0x96a 0x4ead 0x93a6 0x933 0x4fd9 0x9398 0x951 0x5106 0x937a 0x96f 0x5232 0x9358 0x947 0x535f 0x932c 0x947 0x548c 0x9314 0x947 0x55b8 0x92eb 0x942 0x56e5 0x92c8 0x93e 0x5811 0x92ad 0x974 0x593e 0x927b 0x960 0x5a6b 0x9249 0x96b 0x5b97 0x9216 0x98c 0x5cc4 0x91e3 0x98c 0x5df0 0x91ac 0x9b0 0x5f1d 0x9166 0x980 0x604a 0x911d 0x992 0x6176 0x90d5 0x99f 0x62a3 0x90a8 0x9bd 0x63d0 0x9095 0x9cd 0x64fc 0x9094 0xa21 0x6629 0x907e 0xa38 0x6755 0x9076 0xaac 0x6882 0x9055 0xaf6 0x69af 0x9005 0xb7f 0x6adb 0x8f12 0xb66 0x6c08 0x8d5c 0xb7f 0x6d34 0x8b18 0xc24 0x6e61 0x87fe 0xd09 0x6f8e 0x82cb 0x1010 0x70ba 0x774c 0x2e95 0x71e7 0x774c 0x2e95 0x7313 0x774c 0x2e95 0x7440 0x774c 0x2e95>;
		battery0_profile_t3_num = <0x64>;
		battery0_profile_t3_col = <0x3>;
		battery0_profile_t3 = <0x0 0xa6ea 0xa0f 0x12d 0xa636 0xce4 0x259 0xa5a9 0xd2f 0x386 0xa51d 0xd93 0x4b2 0xa4af 0xdc6 0x5df 0xa44b 0xe10 0x70c 0xa3dd 0xe11 0x838 0xa378 0xe5b 0x965 0xa30a 0xe74 0xa91 0xa2a6 0xe8d 0xbbe 0xa242 0xea6 0xceb 0xa1ca 0xea7 0xe17 0xa166 0xed9 0xf44 0xa101 0xef1 0x1070 0xa093 0xef2 0x119d 0xa039 0xf0b 0x12ca 0x9fde 0xf23 0x13f6 0x9fa4 0xf2d 0x1523 0x9f82 0xfbc 0x1650 0x9f2d 0xfe6 0x177c 0x9e8b 0xfa2 0x18a9 0x9dde 0xfb5 0x19d5 0x9d10 0xf87 0x1b02 0x9c7c 0xf85 0x1c2f 0x9bfc 0xf72 0x1d5b 0x9b99 0xfa2 0x1e88 0x9b49 0xfb9 0x1fb4 0x9afc 0xfbb 0x20e1 0x9ac8 0xfd2 0x220e 0x9a82 0xfd0 0x233a 0x9a42 0xfb2 0x2467 0x99d5 0xf6c 0x2593 0x9979 0xf4e 0x26c0 0x990b 0xf00 0x27ed 0x98a0 0xea6 0x2919 0x984f 0xea3 0x2a46 0x97f7 0xe8d 0x2b72 0x97b0 0xe82 0x2c9f 0x976b 0xe31 0x2dcc 0x9732 0xe7a 0x2ef8 0x9707 0xea6 0x3025 0x96cc 0xea3 0x3151 0x969a 0xe90 0x327e 0x9667 0xea9 0x33ab 0x962d 0xec2 0x34d7 0x9605 0xedb 0x3604 0x95dc 0xeeb 0x3730 0x95ac 0xec9 0x385d 0x958a 0xf0a 0x398a 0x955b 0xf12 0x3ab6 0x953b 0xf38 0x3be3 0x9515 0xf2b 0x3d10 0x94f5 0xf59 0x3e3c 0x94cf 0xf6e 0x3f69 0x94b1 0xf77 0x4095 0x9491 0xf97 0x41c2 0x946c 0xf77 0x42ef 0x9457 0xfa5 0x441b 0x943a 0xfbe 0x4548 0x9424 0xfd2 0x4674 0x9408 0xfdb 0x47a1 0x93f4 0x100d 0x48ce 0x93dc 0x102c 0x49fa 0x93ba 0x1009 0x4b27 0x93ac 0x1018 0x4c53 0x9390 0x1009 0x4d80 0x9378 0x101d 0x4ead 0x9352 0x1018 0x4fd9 0x9334 0x100e 0x5106 0x931a 0x103b 0x5232 0x930a 0x104a 0x535f 0x92df 0x1036 0x548c 0x92b2 0x1046 0x55b8 0x928d 0x1081 0x56e5 0x9251 0x108c 0x5811 0x9215 0x10b3 0x593e 0x91db 0x10c4 0x5a6b 0x91a4 0x10fe 0x5b97 0x915b 0x1104 0x5cc4 0x910e 0x111d 0x5df0 0x90df 0x1151 0x5f1d 0x90d3 0x11ba 0x604a 0x90bf 0x1207 0x6176 0x90ad 0x12a4 0x62a3 0x909e 0x1346 0x63d0 0x9078 0x13d7 0x64fc 0x9020 0x1492 0x6629 0x8f46 0x1514 0x6755 0x8dac 0x1596 0x6882 0x8b81 0x16d4 0x69af 0x888a 0x18af 0x6adb 0x83d6 0x1d63 0x6c08 0x7b28 0x3593 0x6d34 0x7364 0x26c5 0x6e61 0x7364 0x26c5 0x6f8e 0x7364 0x26c5 0x70ba 0x7364 0x26c5 0x71e7 0x7364 0x26c5 0x7313 0x7364 0x26c5 0x7440 0x7364 0x26c5>;
		battery0_profile_t4_num = <0x64>;
		battery0_profile_t4_col = <0x3>;
		battery0_profile_t4 = <0x0 0xa62c 0xdb6 0x12d 0xa564 0x1177 0x259 0xa4a5 0x1380 0x386 0xa3bf 0x15e2 0x4b2 0xa333 0x176f 0x5df 0xa2b1 0x172b 0x70c 0xa239 0x1784 0x838 0xa1ca 0x17a9 0x965 0xa15d 0x16c8 0xa91 0xa10d 0x174b 0xbbe 0xa0bc 0x17dc 0xceb 0xa06c 0x1770 0xe17 0xa007 0x177b 0xf44 0x9f84 0x1795 0x1070 0x9ee3 0x1713 0x119d 0x9e44 0x16b5 0x12ca 0x9db9 0x15dd 0x13f6 0x9d58 0x1586 0x1523 0x9d08 0x16da 0x1650 0x9cad 0x1639 0x177c 0x9c35 0x158f 0x18a9 0x9bc7 0x14fa 0x19d5 0x9b45 0x14eb 0x1b02 0x9aeb 0x133e 0x1c2f 0x9a86 0x14ea 0x1d5b 0x9a22 0x136d 0x1e88 0x99c8 0x141c 0x1fb4 0x9979 0x13d4 0x20e1 0x9932 0x14cc 0x220e 0x98e2 0x13e7 0x233a 0x989c 0x14a0 0x2467 0x984c 0x14a3 0x2593 0x9806 0x14f9 0x26c0 0x97c2 0x14e6 0x27ed 0x9772 0x14a0 0x2919 0x972c 0x13e2 0x2a46 0x96f0 0x1432 0x2b72 0x96b4 0x140b 0x2c9f 0x9677 0x1478 0x2dcc 0x9646 0x1457 0x2ef8 0x9627 0x1345 0x3025 0x95f5 0x142c 0x3151 0x95c3 0x1529 0x327e 0x959b 0x148d 0x33ab 0x9573 0x14b2 0x34d7 0x954b 0x1449 0x3604 0x952d 0x14be 0x3730 0x94fb 0x14b5 0x385d 0x94dd 0x14ca 0x398a 0x94bf 0x1510 0x3ab6 0x94a2 0x1540 0x3be3 0x9484 0x164d 0x3d10 0x9466 0x14f2 0x3e3c 0x9452 0x162f 0x3f69 0x9434 0x155e 0x4095 0x9416 0x1556 0x41c2 0x9402 0x15f1 0x42ef 0x93ee 0x1508 0x441b 0x93cf 0x15ff 0x4548 0x93b2 0x1628 0x4674 0x939e 0x16b7 0x47a1 0x9389 0x1983 0x48ce 0x9361 0x19ae 0x49fa 0x9343 0x1a46 0x4b27 0x9325 0x19cf 0x4c53 0x92fd 0x1ab2 0x4d80 0x92d6 0x1b26 0x4ead 0x92a4 0x1afe 0x4fd9 0x927c 0x1afe 0x5106 0x924a 0x1afe 0x5232 0x9222 0x1afe 0x535f 0x91ef 0x1afe 0x548c 0x91be 0x1afe 0x55b8 0x9195 0x1afe 0x56e5 0x9163 0x1afe 0x5811 0x913b 0x1afe 0x593e 0x911d 0x1afe 0x5a6b 0x90ea 0x1afe 0x5b97 0x9099 0x1b16 0x5cc4 0x9015 0x1ee6 0x5df0 0x8f4a 0x1ee6 0x5f1d 0x8e2e 0x1ee6 0x604a 0x8c98 0x1f0b 0x6176 0x8a6f 0x238c 0x62a3 0x8711 0x238c 0x63d0 0x82d1 0x238c 0x64fc 0x8227 0x238c 0x6629 0x81d6 0x238c 0x6755 0x812c 0x238c 0x6882 0x804e 0x238c 0x69af 0x7f1f 0x238c 0x6adb 0x7d37 0x238c 0x6c08 0x79bd 0x238c 0x6d34 0x76ac 0x238c 0x6e61 0x76ac 0x238c 0x6f8e 0x76ac 0x238c 0x70ba 0x76ac 0x238c 0x71e7 0x76ac 0x238c 0x7313 0x76ac 0x238c 0x7440 0x76ac 0x238c>;
		battery0_profile_t5_num = <0x64>;
		battery0_profile_t5_col = <0x3>;
		battery0_profile_t5 = <0x0 0xa5b4 0x251c 0x12d 0xa4e2 0x16a9 0x259 0xa3fb 0x1820 0x386 0xa2e3 0x1981 0x4b2 0xa239 0x1c54 0x5df 0xa1a3 0x1d1b 0x70c 0xa12b 0x1d99 0x838 0xa0b3 0x1e45 0x965 0xa04f 0x1e16 0xa91 0xa009 0x1eab 0xbbe 0x9fc3 0x1ef7 0xceb 0x9f86 0x1f42 0xe17 0x9f2a 0x1fa4 0xf44 0x9e93 0x1fa3 0x1070 0x9dd4 0x1f8b 0x119d 0x9d0c 0x1f89 0x12ca 0x9c55 0x1f59 0x13f6 0x9bd5 0x1f5c 0x1523 0x9b67 0x1f8e 0x1650 0x9b04 0x1fb8 0x177c 0x9ab4 0x1f78 0x18a9 0x9a65 0x1fbf 0x19d5 0x9a1f 0x1fdc 0x1b02 0x99e2 0x201d 0x1c2f 0x9991 0x1fe9 0x1d5b 0x9936 0x1fa4 0x1e88 0x98d2 0x1f9e 0x1fb4 0x987a 0x1f57 0x20e1 0x9832 0x1f3e 0x220e 0x97da 0x1f27 0x233a 0x9793 0x1f25 0x2467 0x974f 0x1f18 0x2593 0x971d 0x1f74 0x26c0 0x96ea 0x1f8e 0x27ed 0x96ae 0x1f95 0x2919 0x9674 0x1f1b 0x2a46 0x964a 0x1f90 0x2b72 0x960f 0x1fc8 0x2c9f 0x95de 0x2021 0x2dcc 0x95b8 0x2024 0x2ef8 0x95a0 0x203d 0x3025 0x956e 0x2059 0x3151 0x953d 0x2082 0x327e 0x9518 0x2078 0x33ab 0x9501 0x20d3 0x34d7 0x94da 0x20e3 0x3604 0x94bb 0x20bd 0x3730 0x9493 0x20e9 0x385d 0x946d 0x20f1 0x398a 0x9459 0x2127 0x3ab6 0x9445 0x216a 0x3be3 0x942d 0x2183 0x3d10 0x940a 0x2198 0x3e3c 0x93ff 0x21a9 0x3f69 0x93e9 0x21f8 0x4095 0x93d0 0x21f0 0x41c2 0x93cb 0x2237 0x42ef 0x93ad 0x2265 0x441b 0x938e 0x2279 0x4548 0x9374 0x2287 0x4674 0x9366 0x22d7 0x47a1 0x9346 0x233b 0x48ce 0x9320 0x238c 0x49fa 0x9300 0x23a4 0x4b27 0x92d6 0x2418 0x4c53 0x92a4 0x2459 0x4d80 0x9272 0x247c 0x4ead 0x9240 0x24d1 0x4fd9 0x920a 0x254f 0x5106 0x91c8 0x25cc 0x5232 0x9191 0x265e 0x535f 0x9152 0x2730 0x548c 0x9127 0x27c1 0x55b8 0x90f7 0x2859 0x56e5 0x90d2 0x2963 0x5811 0x90b8 0x2aae 0x593e 0x90a7 0x2c0d 0x5a6b 0x9076 0x2d98 0x5b97 0x901e 0x2fc4 0x5cc4 0x8f87 0x31ec 0x5df0 0x8e58 0x33f4 0x5f1d 0x8c86 0x3669 0x604a 0x89fa 0x39dc 0x6176 0x864c 0x3f52 0x62a3 0x80b8 0x42ea 0x63d0 0x79c6 0x33dd 0x64fc 0x78e6 0x335e 0x6629 0x78e6 0x335e 0x6755 0x78e6 0x335e 0x6882 0x78e6 0x335e 0x69af 0x78e6 0x335e 0x6adb 0x78e6 0x335e 0x6c08 0x78e6 0x335e 0x6d34 0x78e6 0x335e 0x6e61 0x78e6 0x335e 0x6f8e 0x78e6 0x335e 0x70ba 0x78e6 0x335e 0x71e7 0x78e6 0x335e 0x7313 0x78e6 0x335e 0x7440 0x78e6 0x335e>;
		phandle = <0xaa>;
	};

	md_ccif3@1023f000 {
		compatible = "mediatek,md_ccif3";
		reg = <0x0 0x1023f000 0x0 0x1000>;
	};

	sspm@10440000 {
		compatible = "mediatek,sspm";
		reg = <0x0 0x10440000 0x0 0x10000 0x0 0x10450000 0x0 0x100 0x0 0x10451000 0x0 0x8 0x0 0x10460000 0x0 0x100 0x0 0x10461000 0x0 0x8 0x0 0x10470000 0x0 0x100 0x0 0x10471000 0x0 0x8 0x0 0x10480000 0x0 0x100 0x0 0x10481000 0x0 0x8 0x0 0x10490000 0x0 0x100 0x0 0x10491000 0x0 0x8>;
		reg-names = "cfgreg", "mbox0_base", "mbox0_ctrl", "mbox1_base", "mbox1_ctrl", "mbox2_base", "mbox2_ctrl", "mbox3_base", "mbox3_ctrl", "mbox4_base", "mbox4_ctrl";
		interrupts = <0x0 0xd7 0x4 0x0 0xda 0x4 0x0 0xdb 0x4 0x0 0xdc 0x4 0x0 0xdd 0x4 0x0 0xde 0x4>;
		interrupt-names = "ipc", "mbox0", "mbox1", "mbox2", "mbox3", "mbox4";
	};

	gic500@0c000000 {
		compatible = "mediatek,gic500";
		reg = <0x0 0xc000000 0x0 0x400000>;
	};

	gic_cpu@0c400000 {
		compatible = "mediatek,gic_cpu";
		reg = <0x0 0xc400000 0x0 0x40000>;
	};

	lastbus@10001000 {
		compatible = "mediatek,lastbus-v1";
		reg = <0x0 0x10001000 0x0 0x1000 0x0 0x10003000 0x0 0x1000>;
	};

	dfd@10200b00 {
		compatible = "mediatek,dfd";
		reg = <0x0 0x10200b00 0x0 0x10000>;
		mediatek,enabled = <0x1>;
		mediatek,chain_length = <0xa7f8>;
		mediatek,rg_dfd_timeout = <0xa0>;
	};

	dfd_cache {
		compatible = "mediatek,dfd_cache";
		mediatek,enabled = <0x0>;
		mediatek,rg_dfd_timeout = <0x3e80>;
		phandle = <0xab>;
	};

	dbg_cti@0d020000 {
		compatible = "mediatek,dbg_cti";
		reg = <0x0 0xd020000 0x0 0x10000>;
	};

	dbg_etr@0d030000 {
		compatible = "mediatek,dbg_etr";
		reg = <0x0 0xd030000 0x0 0x10000>;
	};

	dbg_funnel@0d040000 {
		compatible = "mediatek,dbg_funnel";
		reg = <0x0 0xd040000 0x0 0x10000>;
	};

	dbg_dem@0d0a0000 {
		compatible = "mediatek,dbg_dem";
		reg = <0x0 0xd0a0000 0x0 0x10000>;
		interrupts = <0x0 0x9d 0x8>;
	};

	dbg_mdsys1@0d0c0000 {
		compatible = "mediatek,dbg_mdsys1";
		reg = <0x0 0xd0c0000 0x0 0x40000>;
	};

	dbg_apmcu_mp0@0d400000 {
		compatible = "mediatek,dbg_apmcu_mp0";
		reg = <0x0 0xd400000 0x0 0x1000>;
	};

	dbg_apmcu_mp0@0d410000 {
		compatible = "mediatek,dbg_apmcu_mp0";
		reg = <0x0 0xd410000 0x0 0x1000>;
	};

	dbg_apmcu_mp0@0d420000 {
		compatible = "mediatek,dbg_apmcu_mp0";
		reg = <0x0 0xd420000 0x0 0x1000>;
	};

	dbg_apmcu_mp0@0d430000 {
		compatible = "mediatek,dbg_apmcu_mp0";
		reg = <0x0 0xd430000 0x0 0x1000>;
	};

	dbg_apmcu_mp0@0d440000 {
		compatible = "mediatek,dbg_apmcu_mp0";
		reg = <0x0 0xd440000 0x0 0x1000>;
	};

	dbg_apmcu_mp0@0d510000 {
		compatible = "mediatek,dbg_apmcu_mp0";
		reg = <0x0 0xd510000 0x0 0x1000>;
	};

	dbg_apmcu_mp0@0d520000 {
		compatible = "mediatek,dbg_apmcu_mp0";
		reg = <0x0 0xd520000 0x0 0x1000>;
	};

	dbg_apmcu_mp0@0d530000 {
		compatible = "mediatek,dbg_apmcu_mp0";
		reg = <0x0 0xd530000 0x0 0x1000>;
	};

	dbg_apmcu_mp0@0d540000 {
		compatible = "mediatek,dbg_apmcu_mp0";
		reg = <0x0 0xd540000 0x0 0x1000>;
	};

	dbg_apmcu_mp0@0d610000 {
		compatible = "mediatek,dbg_apmcu_mp0";
		reg = <0x0 0xd610000 0x0 0x1000>;
	};

	dbg_apmcu_mp0@0d620000 {
		compatible = "mediatek,dbg_apmcu_mp0";
		reg = <0x0 0xd620000 0x0 0x1000>;
	};

	dbg_apmcu_mp0@0d630000 {
		compatible = "mediatek,dbg_apmcu_mp0";
		reg = <0x0 0xd630000 0x0 0x1000>;
	};

	dbg_apmcu_mp0@0d640000 {
		compatible = "mediatek,dbg_apmcu_mp0";
		reg = <0x0 0xd640000 0x0 0x1000>;
	};

	dbg_apmcu_mp0@0d710000 {
		compatible = "mediatek,dbg_apmcu_mp0";
		reg = <0x0 0xd710000 0x0 0x1000>;
	};

	dbg_apmcu_mp0@0d720000 {
		compatible = "mediatek,dbg_apmcu_mp0";
		reg = <0x0 0xd720000 0x0 0x1000>;
	};

	dbg_apmcu_mp0@0d730000 {
		compatible = "mediatek,dbg_apmcu_mp0";
		reg = <0x0 0xd730000 0x0 0x1000>;
	};

	dbg_apmcu_mp0@0d740000 {
		compatible = "mediatek,dbg_apmcu_mp0";
		reg = <0x0 0xd740000 0x0 0x1000>;
	};

	dbg_apmcu_mp1@0d800000 {
		compatible = "mediatek,dbg_apmcu_mp1";
		reg = <0x0 0xd800000 0x0 0x1000>;
	};

	dbg_apmcu_mp1@0d810000 {
		compatible = "mediatek,dbg_apmcu_mp1";
		reg = <0x0 0xd810000 0x0 0x1000>;
	};

	dbg_apmcu_mp1@0d820000 {
		compatible = "mediatek,dbg_apmcu_mp1";
		reg = <0x0 0xd820000 0x0 0x1000>;
	};

	dbg_apmcu_mp1@0d830000 {
		compatible = "mediatek,dbg_apmcu_mp1";
		reg = <0x0 0xd830000 0x0 0x1000>;
	};

	dbg_apmcu_mp1@0d840000 {
		compatible = "mediatek,dbg_apmcu_mp1";
		reg = <0x0 0xd840000 0x0 0x1000>;
	};

	dbg_apmcu_mp1@0d910000 {
		compatible = "mediatek,dbg_apmcu_mp1";
		reg = <0x0 0xd910000 0x0 0x1000>;
	};

	dbg_apmcu_mp1@0d920000 {
		compatible = "mediatek,dbg_apmcu_mp1";
		reg = <0x0 0xd920000 0x0 0x1000>;
	};

	dbg_apmcu_mp1@0d930000 {
		compatible = "mediatek,dbg_apmcu_mp1";
		reg = <0x0 0xd930000 0x0 0x1000>;
	};

	dbg_apmcu_mp1@0d940000 {
		compatible = "mediatek,dbg_apmcu_mp1";
		reg = <0x0 0xd940000 0x0 0x1000>;
	};

	dbg_apmcu_mp1@0da10000 {
		compatible = "mediatek,dbg_apmcu_mp1";
		reg = <0x0 0xda10000 0x0 0x1000>;
	};

	dbg_apmcu_mp1@0da20000 {
		compatible = "mediatek,dbg_apmcu_mp1";
		reg = <0x0 0xda20000 0x0 0x1000>;
	};

	dbg_apmcu_mp1@0da30000 {
		compatible = "mediatek,dbg_apmcu_mp1";
		reg = <0x0 0xda30000 0x0 0x1000>;
	};

	dbg_apmcu_mp1@0da40000 {
		compatible = "mediatek,dbg_apmcu_mp1";
		reg = <0x0 0xda40000 0x0 0x1000>;
	};

	dbg_apmcu_mp1@0db10000 {
		compatible = "mediatek,dbg_apmcu_mp1";
		reg = <0x0 0xdb10000 0x0 0x1000>;
	};

	dbg_apmcu_mp1@0db20000 {
		compatible = "mediatek,dbg_apmcu_mp1";
		reg = <0x0 0xdb20000 0x0 0x1000>;
	};

	dbg_apmcu_mp1@0db30000 {
		compatible = "mediatek,dbg_apmcu_mp1";
		reg = <0x0 0xdb30000 0x0 0x1000>;
	};

	dbg_apmcu_mp1@0db40000 {
		compatible = "mediatek,dbg_apmcu_mp1";
		reg = <0x0 0xdb40000 0x0 0x1000>;
	};

	infra_dbgsystop_cpu0@0e000000 {
		compatible = "mediatek,infra_dbgsystop_cpu0";
		reg = <0x0 0xe000000 0x0 0x100000>;
	};

	infra_dbgsystop_cpu1@0e100000 {
		compatible = "mediatek,infra_dbgsystop_cpu1";
		reg = <0x0 0xe100000 0x0 0x100000>;
	};

	infra_dbgsystop_cpu2@0e200000 {
		compatible = "mediatek,infra_dbgsystop_cpu2";
		reg = <0x0 0xe200000 0x0 0x100000>;
	};

	infra_dbgsystop_cpu3@0e300000 {
		compatible = "mediatek,infra_dbgsystop_cpu3";
		reg = <0x0 0xe300000 0x0 0x100000>;
	};

	infra_dbgsystop_cpu4@0e400000 {
		compatible = "mediatek,infra_dbgsystop_cpu4";
		reg = <0x0 0xe400000 0x0 0x100000>;
	};

	infra_dbgsystop_cpu5@0e500000 {
		compatible = "mediatek,infra_dbgsystop_cpu5";
		reg = <0x0 0xe500000 0x0 0x100000>;
	};

	infra_dbgsystop_cpu6@0e600000 {
		compatible = "mediatek,infra_dbgsystop_cpu6";
		reg = <0x0 0xe600000 0x0 0x100000>;
	};

	infra_dbgsystop_cpu7@0e700000 {
		compatible = "mediatek,infra_dbgsystop_cpu7";
		reg = <0x0 0xe700000 0x0 0x100000>;
	};

	ap_dma@11000000 {
		compatible = "mediatek,ap_dma";
		reg = <0x0 0x11000000 0x0 0x1000>;
		interrupts = <0x0 0x66 0x8>;
	};

	auxadc@11001000 {
		compatible = "mediatek,mt6768-auxadc";
		reg = <0x0 0x11001000 0x0 0x1000>;
		interrupts = <0x0 0x42 0x2>;
		clocks = <0x21 0x21>;
		clock-names = "main";
		#io-channel-cells = <0x1>;
		mediatek,cali-en-bit = <0x14>;
		mediatek,cali-ge-bit = <0xa>;
		mediatek,cali-oe-bit = <0x0>;
		mediatek,cali-efuse-index = <0x6a>;
		phandle = <0x23>;
	};

	dma-controller@11000980 {
		compatible = "mediatek,mt6577-uart-dma";
		reg = <0x0 0x11000980 0x0 0x80 0x0 0x11000a00 0x0 0x80 0x0 0x11000a80 0x0 0x80 0x0 0x11000b00 0x0 0x80>;
		interrupts = <0x0 0x66 0x8 0x0 0x67 0x8 0x0 0x68 0x8 0x0 0x72 0x8>;
		clocks = <0x21 0x26>;
		clock-names = "apdma";
		#dma-cells = <0x1>;
		dma-bits = <0x22>;
		phandle = <0x2f>;
	};

	serial@11002000 {
		compatible = "mediatek,mt6577-uart";
		reg = <0x0 0x11002000 0x0 0x1000>;
		interrupts = <0x0 0x70 0x8>;
		clocks = <0x13 0x21 0x16>;
		clock-names = "baud", "bus";
		dmas = <0x2f 0x0 0x2f 0x1>;
		dma-names = "tx", "rx";
		phandle = <0xac>;
	};

	serial@11003000 {
		compatible = "mediatek,mt6577-uart";
		reg = <0x0 0x11003000 0x0 0x1000>;
		interrupts = <0x0 0x71 0x8>;
		clocks = <0x13 0x21 0x17>;
		clock-names = "baud", "bus";
		dmas = <0x2f 0x2 0x2f 0x3>;
		dma-names = "tx", "rx";
		phandle = <0xad>;
	};

	i2c_common {
		compatible = "mediatek,i2c_common";
		dma_support = [03];
		idvfs = [01];
		set_dt_div = [01];
		check_max_freq = [01];
		ver = [02];
		set_ltiming = [01];
		ext_time_config = [18 01];
		cnt_constraint = [01];
		control_irq_sel = [01];
		phandle = <0xae>;
	};

	pwm@11006000 {
		compatible = "mediatek,pwm";
		reg = <0x0 0x11006000 0x0 0x1000>;
		interrupts = <0x0 0x62 0x8>;
		clocks = <0x21 0x10 0x21 0x11 0x21 0x12 0x21 0x13 0x21 0x14 0x21 0x30 0x21 0xf 0x21 0x15>;
		clock-names = "PWM1-main", "PWM2-main", "PWM3-main", "PWM4-main", "PWM5-main", "PWM6-main", "PWM-HCLK-main", "PWM-main";
	};

	i2c0@11007000 {
		compatible = "mediatek,i2c";
		id = <0x0>;
		reg = <0x0 0x11007000 0x0 0x1000 0x0 0x11000080 0x0 0x80>;
		interrupts = <0x0 0x69 0x8>;
		clocks = <0x21 0xb 0x21 0x26>;
		clock-names = "main", "dma";
		clock-div = <0x5>;
		scl-gpio-id = <0x53>;
		sda-gpio-id = <0x52>;
		gpio_start = <0x10002a00>;
		mem_len = <0x200>;
		eh_cfg = <0x30>;
		pu_cfg = <0x70>;
		rsel_cfg = <0x90>;
		aed = <0x1a>;
		phandle = <0xaf>;

		i2c_lcd_bias@3e {
			compatible = "ti,tps65132";
			reg = <0x3e>;
			status = "okay";
			phandle = <0xb0>;
		};

		fuelguage@62 {
			compatible = "cellwise,cw2015";
			reg = <0x62>;
			bat_first_startrange = <0x30d40>;
			bat_first_endrange = <0x61a80>;
			bat_second_startrange = <0x927c0>;
			bat_second_endrange = <0xc3500>;
			bat_third_startrange = <0xdbba0>;
			bat_third_endrange = <0x10c8e0>;
			first_bat_capacity = <0x1324>;
			sec_bat_capacity = <0x1306>;
			third_bat_capacity = <0x1388>;
			bat_channel_num = <0x3>;
			enable_iio_interface;
			io-channels = <0x23 0x3>;
			io-channel-names = "thermistor-ch3";
			batinfo_first = <0x180a6266 0x68686767 0x635d6759 0x6d534741 0x39312c29 0x2d3a454b 0x1a640b85 0x1d3b4351 0x6568686d 0x401c6d55 0xb1c3762 0x8294990e 0x237696a4 0x8090bbcb 0x2f0064a5 0xb50e0929>;
			batinfo_second = <0x180a6b6b 0x6b6b6867 0x60685a59 0x635a483f 0x362f2924 0x2830414f 0x284a0b85 0x3455566f 0x827f8081 0x3e195d57 0xb36295a 0x8394990d 0x297a96a8 0x8095aacb 0x2f0064a5 0xb50e08b9>;
			batinfo_third = <0x18145f69 0x6f6b6a68 0x62656159 0x64594941 0x37312721 0x2735414f 0x21460b85 0x2848516c 0x817e7e7e 0x3e1b5c46 0xe205287 0x8f919452 0x828c9296 0x95a6c3cb 0x2f7d64a5 0xb50e0869>;
			batinfo_default = <0x180a6266 0x68686767 0x635d6759 0x6d534741 0x39312c29 0x2d3a454b 0x1a640b85 0x1d3b4351 0x6568686d 0x401c6d55 0xb1c3762 0x8294990e 0x237696a4 0x8090bbcb 0x2f0064a5 0xb50e0929>;
		};
	};

	i2c1@11008000 {
		compatible = "mediatek,i2c";
		id = <0x1>;
		reg = <0x0 0x11008000 0x0 0x1000 0x0 0x11000100 0x0 0x80>;
		interrupts = <0x0 0x6a 0x8>;
		clocks = <0x21 0xb 0x21 0x26>;
		clock-names = "main", "dma";
		clock-div = <0x5>;
		scl-gpio-id = <0x54>;
		sda-gpio-id = <0x51>;
		gpio_start = <0x10002a00>;
		mem_len = <0x200>;
		eh_cfg = <0x30>;
		pu_cfg = <0x70>;
		rsel_cfg = <0x90>;
		aed = <0x1a>;
		phandle = <0xb1>;
	};

	i2c2@11009000 {
		compatible = "mediatek,i2c";
		id = <0x2>;
		reg = <0x0 0x11009000 0x0 0x1000 0x0 0x11000180 0x0 0x180>;
		interrupts = <0x0 0x6b 0x8>;
		clocks = <0x21 0xb 0x21 0x26>;
		clock-names = "main", "dma";
		clock-div = <0x5>;
		scl-gpio-id = <0x67>;
		sda-gpio-id = <0x68>;
		gpio_start = <0x10002800>;
		mem_len = <0x200>;
		eh_cfg = <0x40>;
		pu_cfg = <0xa0>;
		rsel_cfg = <0xf0>;
		aed = <0x1a>;
		ch_offset_default = <0x100>;
		ch_offset_ccu = <0x200>;
		phandle = <0xb2>;
	};

	i2c3@1100f000 {
		compatible = "mediatek,i2c";
		id = <0x3>;
		reg = <0x0 0x1100f000 0x0 0x1000 0x0 0x11000300 0x0 0x100>;
		interrupts = <0x0 0x6c 0x8>;
		clocks = <0x21 0xb 0x21 0x26>;
		clock-names = "main", "dma";
		clock-div = <0x5>;
		scl-gpio-id = <0x32>;
		sda-gpio-id = <0x33>;
		gpio_start = <0x10002600>;
		mem_len = <0x200>;
		eh_cfg = <0x30>;
		pu_cfg = <0x60>;
		rsel_cfg = <0x90>;
		aed = <0x1a>;
		ch_offset_default = <0x100>;
		ch_offset_ccu = <0x200>;
		phandle = <0xb3>;
	};

	i2c4@11011000 {
		compatible = "mediatek,i2c";
		id = <0x4>;
		reg = <0x0 0x11011000 0x0 0x1000 0x0 0x11000400 0x0 0x180>;
		interrupts = <0x0 0x6d 0x8>;
		clocks = <0x21 0xb 0x21 0x26>;
		clock-names = "main", "dma";
		clock-div = <0x5>;
		scl-gpio-id = <0x69>;
		sda-gpio-id = <0x6a>;
		gpio_start = <0x10002800>;
		mem_len = <0x200>;
		eh_cfg = <0x40>;
		pu_cfg = <0xa0>;
		rsel_cfg = <0xf0>;
		aed = <0x1a>;
		ch_offset_default = <0x100>;
		ch_offset_ccu = <0x200>;
		phandle = <0xb4>;
	};

	i2c5@11016000 {
		compatible = "mediatek,i2c";
		id = <0x5>;
		reg = <0x0 0x11016000 0x0 0x1000 0x0 0x11000580 0x0 0x80>;
		interrupts = <0x0 0x93 0x8>;
		clocks = <0x21 0xb 0x21 0x26>;
		clock-names = "main", "dma";
		clock-div = <0x5>;
		scl-gpio-id = <0x30>;
		sda-gpio-id = <0x31>;
		gpio_start = <0x10002600>;
		mem_len = <0x200>;
		eh_cfg = <0x30>;
		pu_cfg = <0x60>;
		rsel_cfg = <0x90>;
		aed = <0x1a>;
		phandle = <0xb5>;
	};

	i2c6@1100d000 {
		compatible = "mediatek,i2c";
		id = <0x6>;
		reg = <0x0 0x1100d000 0x0 0x1000 0x0 0x11000600 0x0 0x80>;
		interrupts = <0x0 0x94 0x8>;
		clocks = <0x21 0xb 0x21 0x26>;
		clock-names = "main", "dma";
		clock-div = <0x5>;
		scl-gpio-id = <0x59>;
		sda-gpio-id = <0x5a>;
		gpio_start = <0x10002000>;
		mem_len = <0x200>;
		eh_cfg = <0x30>;
		pu_cfg = <0x60>;
		rsel_cfg = <0x90>;
		aed = <0x1a>;
		phandle = <0xb6>;
	};

	i2c7@11004000 {
		compatible = "mediatek,i2c";
		id = <0x7>;
		reg = <0x0 0x11004000 0x0 0x1000 0x0 0x11000680 0x0 0x180>;
		interrupts = <0x0 0x6e 0x8>;
		clocks = <0x21 0xb 0x21 0x26>;
		clock-names = "main", "dma";
		clock-div = <0x5>;
		scl-gpio-id = <0xaf>;
		sda-gpio-id = <0xb0>;
		gpio_start = <0x10002600>;
		mem_len = <0x200>;
		eh_cfg = <0x30>;
		pu_cfg = <0x60>;
		rsel_cfg = <0x90>;
		aed = <0x1a>;
		#address-cells = <0x1>;
		#size-cells = <0x0>;
		phandle = <0xb7>;

		rt-swchg@53 {
			compatible = "richtek,swchg";
			reg = <0x53>;
			status = "okay";
			rt,intr_gpio = <0x1e 0x13 0x0>;
			rt,intr_gpio_num = <0x13>;

			rt9471 {
				chg_name = "secondary_chg";
				chg_alias_name = "rt9471_chg";
				rm-dev-addr = [53];
				rm-name = "rt9471";
				interrupt-names = "wdt", "chg_mivr", "vbus_gd", "vac_ov", "chg_rdy", "chg_done", "chg_tout", "chg_batov", "detach";
				vac_ovp = <0xd59f80>;
				mivr = <0x432380>;
				aicr = <0x7a120>;
				cv = <0x432380>;
				ichg = <0xf4240>;
				ieoc = <0x30d40>;
				safe_tmr = <0xa>;
				wdt = <0x28>;
				mivr_track = <0x0>;
				en_safe_tmr;
				en_qon_rst;
			};
		};

		rt9467@5b {
			compatible = "richtek,rt9467";
			reg = <0x5b>;
			rt,intr_gpio_num = <0x14>;
			rt,intr_gpio = <0x1e 0x14 0x0>;
			interrupt-names = "wdtmri", "chg_mivr", "chg_aiclmeasi", "attachi", "detachi", "pwr_rdy", "chg_statci", "chg_ieoci";
			status = "okay";
			charger_name = "primary_chg";
			regmap_name = "rt9467_primary";
			regmap_represent_slave_addr = <0x5b>;
			ichg = <0x1e8480>;
			aicr = <0x7a120>;
			mivr = <0x432380>;
			cv = <0x432380>;
			ieoc = <0x3d090>;
			safety_timer = <0xc>;
			ircmp_resistor = <0x61a8>;
			ircmp_vclamp = <0x7d00>;
			en_te;
			en_wdt;
			en_chgdet;
			otgen-gpio = <0x1e 0x39 0x0>;
		};
	};

	i2c8@11005000 {
		compatible = "mediatek,i2c";
		id = <0x8>;
		reg = <0x0 0x11005000 0x0 0x1000 0x0 0x11000800 0x0 0x180>;
		interrupts = <0x0 0x6f 0x8>;
		clocks = <0x21 0xb 0x21 0x26>;
		clock-names = "main", "dma";
		clock-div = <0x5>;
		aed = <0x1a>;
		phandle = <0xb8>;
	};

	spi2@11012000 {
		compatible = "mediatek,mt6765-spi";
		mediatek,pad-select = <0x0>;
		reg = <0x0 0x11012000 0x0 0x1000>;
		interrupts = <0x0 0x91 0x8>;
		clocks = <0x12 0xb 0x12 0x5b 0x21 0x37>;
		clock-names = "parent-clk", "sel-clk", "spi-clk";
		phandle = <0xb9>;
	};

	spi0@1100a000 {
		compatible = "mediatek,mt6765-spi";
		mediatek,pad-select = <0x0>;
		reg = <0x0 0x1100a000 0x0 0x1000>;
		interrupts = <0x0 0x8a 0x8>;
		clocks = <0x12 0xb 0x12 0x5b 0x21 0x1b>;
		clock-names = "parent-clk", "sel-clk", "spi-clk";
		phandle = <0xba>;
	};

	eem_fsm@1100b000 {
		compatible = "mediatek,eem_fsm";
		reg = <0x0 0x1100b000 0x0 0x1000>;
		interrupts = <0x0 0x8e 0x8>;
		eem-status = <0x1>;
		eem-initmon-little = <0xf>;
		eem-initmon-big = <0xf>;
		eem-initmon-cci = <0xf>;
		eem-initmon-gpu = <0xf>;
		eem-clamp-little = <0x0>;
		eem-clamp-big = <0x0>;
		eem-clamp-cci = <0x0>;
		eem-clamp-gpu = <0x0>;
		eem-offset-little = <0xff>;
		eem-offset-big = <0xff>;
		eem-offset-cci = <0xff>;
		eem-offset-gpu = <0xff>;
		phandle = <0xbb>;
	};

	therm_ctrl@1100b000 {
		compatible = "mediatek,therm_ctrl";
		reg = <0x0 0x1100b000 0x0 0x1000>;
		interrupts = <0x0 0x63 0x8>;
		clocks = <0x21 0xa>;
		clock-names = "therm-main";
	};

	thermal-sensor1 {
		compatible = "mediatek,mtboard-thermistor1";
		io-channels = <0x23 0x0>;
		io-channel-names = "thermistor-ch0";
		phandle = <0xbc>;
	};

	thermal-sensor2 {
		compatible = "mediatek,mtboard-thermistor2";
		io-channels = <0x23 0x1>;
		io-channel-names = "thermistor-ch1";
		phandle = <0xbd>;
	};

	drcc {
		compatible = "mediatek,drcc";
		state = <0xff>;
		drcc0_Vref = <0xff>;
		drcc1_Vref = <0xff>;
		drcc2_Vref = <0xff>;
		drcc3_Vref = <0xff>;
		drcc4_Vref = <0xff>;
		drcc5_Vref = <0xff>;
		drcc6_Vref = <0xff>;
		drcc7_Vref = <0xff>;
		drcc0_Hwgatepct = <0xff>;
		drcc1_Hwgatepct = <0xff>;
		drcc2_Hwgatepct = <0xff>;
		drcc3_Hwgatepct = <0xff>;
		drcc4_Hwgatepct = <0xff>;
		drcc5_Hwgatepct = <0xff>;
		drcc6_Hwgatepct = <0xff>;
		drcc7_Hwgatepct = <0xff>;
		drcc0_Code = <0xff>;
		drcc1_Code = <0xff>;
		drcc2_Code = <0xff>;
		drcc3_Code = <0xff>;
		drcc4_Code = <0xff>;
		drcc5_Code = <0xff>;
		drcc6_Code = <0xff>;
		drcc7_Code = <0xff>;
		phandle = <0xbe>;
	};

	btif@1100c000 {
		compatible = "mediatek,btif";
		reg = <0x0 0x1100c000 0x0 0x1000 0x0 0x11000b80 0x0 0x80 0x0 0x11000c00 0x0 0x80>;
		interrupts = <0x0 0x85 0x8 0x0 0x73 0x8 0x0 0x8d 0x8>;
		clocks = <0x21 0x1a 0x21 0x26>;
		clock-names = "btifc", "apdmac";
	};

	consys@18002000 {
		compatible = "mediatek,mt6768-consys";
		#address-cells = <0x2>;
		#size-cells = <0x2>;
		reg = <0x0 0x18002000 0x0 0x1000 0x0 0x10007000 0x0 0x100 0x0 0x10001000 0x0 0x1000 0x0 0x10006000 0x0 0x1000 0x0 0x18007000 0x0 0x1000 0x0 0x180b1000 0x0 0x1000 0x0 0x180a3000 0x0 0x1000 0x0 0x180a5000 0x0 0x800 0x0 0x180c1000 0x0 0x1000 0x0 0x18004000 0x0 0x1000>;
		interrupts = <0x0 0x11c 0x8 0x0 0x4e 0x8 0x0 0x11f 0x1>;
		clocks = <0x22 0x1>;
		clock-names = "conn";
		wifi_ant_swap_gpio = <0x1e 0x6c 0x0>;
		phandle = <0xbf>;
	};

	disp_pwm@1100e000 {
		compatible = "mediatek,disp_pwm";
		reg = <0x0 0x1100e000 0x0 0x1000>;
	};

	spi1@11010000 {
		compatible = "mediatek,mt6765-spi";
		mediatek,pad-select = <0x0>;
		reg = <0x0 0x11010000 0x0 0x1000>;
		interrupts = <0x0 0x8b 0x8>;
		clocks = <0x12 0xb 0x12 0x5b 0x21 0x34>;
		clock-names = "parent-clk", "sel-clk", "spi-clk";
		phandle = <0xc0>;
	};

	spi3@11013000 {
		compatible = "mediatek,mt6765-spi";
		mediatek,pad-select = <0x0>;
		reg = <0x0 0x11013000 0x0 0x1000>;
		interrupts = <0x0 0x92 0x8>;
		clocks = <0x12 0xb 0x12 0x5b 0x21 0x38>;
		clock-names = "parent-clk", "sel-clk", "spi-clk";
		phandle = <0xc1>;
	};

	spi4@11014000 {
		compatible = "mediatek,mt6765-spi";
		mediatek,pad-select = <0x0>;
		reg = <0x0 0x11014000 0x0 0x1000>;
		interrupts = <0x0 0x74 0x8>;
		clocks = <0x12 0xb 0x12 0x5b 0x21 0x41>;
		clock-names = "parent-clk", "sel-clk", "spi-clk";
		phandle = <0xc2>;
	};

	spi5@11015000 {
		compatible = "mediatek,mt6765-spi";
		mediatek,pad-select = <0x0>;
		reg = <0x0 0x11015000 0x0 0x1000>;
		interrupts = <0x0 0x75 0x8>;
		clocks = <0x12 0xb 0x12 0x5b 0x21 0x42>;
		clock-names = "parent-clk", "sel-clk", "spi-clk";
		phandle = <0xc3>;
	};

	imp_iic@11017000 {
		compatible = "mediatek,imp_iic";
		reg = <0x0 0x11017000 0x0 0x1000>;
	};

	nfi@11018000 {
		compatible = "mediatek,nfi";
		reg = <0x0 0x11018000 0x0 0x1000>;
	};

	nfiecc@11019000 {
		compatible = "mediatek,nfiecc";
		reg = <0x0 0x11019000 0x0 0x1000>;
	};

	usb0@11200000 {
		compatible = "mediatek,mt6768-usb20";
		reg = <0x0 0x11200000 0x0 0x10000 0x0 0x11cc0000 0x0 0x10000>;
		interrupts = <0x0 0x61 0x8>;
		mode = <0x2>;
		multipoint = <0x1>;
		num_eps = <0x10>;
		clocks = <0x21 0x8 0x12 0x66 0x12 0x20>;
		clock-names = "usb0", "usb0_clk_top_sel", "usb0_clk_univpll3_d4";
	};

	msdc@11230000 {
		compatible = "mediatek,msdc";
		reg = <0x0 0x11230000 0x0 0x10000>;
		interrupts = <0x0 0x64 0x8>;
		index = [00];
		clk_src = [01];
		bus-width = <0x8>;
		max-frequency = <0xbebc200>;
		cap-mmc-highspeed;
		mmc-ddr-1_8v;
		mmc-hs200-1_8v;
		mmc-hs400-1_8v;
		no-sd;
		no-sdio;
		non-removable;
		pinctl = <0x30>;
		pinctl_hs400 = <0x31>;
		pinctl_hs200 = <0x32>;
		register_setting = <0x33>;
		host_function = [00];
		bootable;
		status = "okay";
		vmmc-supply = <0x34>;
		clocks = <0x21 0x4c 0x21 0x1c 0x21 0x44>;
		clock-names = "msdc0-clock", "msdc0-hclock", "msdc0-aes-clock";
		phandle = <0xc4>;
	};

	msdc@11240000 {
		compatible = "mediatek,msdc";
		reg = <0x0 0x11240000 0x0 0x10000>;
		interrupts = <0x0 0x65 0x8>;
		index = [01];
		clk_src = [02];
		bus-width = <0x4>;
		max-frequency = <0xbebc200>;
		cap-sd-highspeed;
		sd-uhs-sdr12;
		sd-uhs-sdr25;
		sd-uhs-sdr50;
		sd-uhs-sdr104;
		sd-uhs-ddr50;
		no-mmc;
		no-sdio;
		pinctl = <0x35>;
		pinctl_sdr104 = <0x36>;
		pinctl_sdr50 = <0x37>;
		pinctl_ddr50 = <0x38>;
		register_setting = <0x39>;
		host_function = [01];
		cd_level = [01];
		cd-gpios = <0x1e 0x12 0x0>;
		status = "okay";
		vmmc-supply = <0x3a>;
		vqmmc-supply = <0x3b>;
		clocks = <0x21 0x4d 0x21 0x1d>;
		clock-names = "msdc1-clock", "msdc1-hclock";
		phandle = <0xc5>;
	};

	msdc0_top@11cd0000 {
		compatible = "mediatek,msdc0_top";
		reg = <0x0 0x11cd0000 0x0 0x1000>;
	};

	msdc1_top@11c90000 {
		compatible = "mediatek,msdc1_top";
		reg = <0x0 0x11c90000 0x0 0x1000>;
	};

	usb1p_sif@11210000 {
		compatible = "mediatek,usb1p_sif";
		reg = <0x0 0x11210000 0x0 0x10000>;
	};

	audio@11220000 {
		compatible = "mediatek,audio", "syscon";
		reg = <0x0 0x11220000 0x0 0x1000>;
		#clock-cells = <0x1>;
		phandle = <0x3d>;
	};

	mt6768-afe-pcm@11220000 {
		compatible = "mediatek,mt6768-sound";
		reg = <0x0 0x11220000 0x0 0x1000>;
		interrupts = <0x0 0xa9 0x8>;
		topckgen = <0x12>;
		apmixed = <0x3c>;
		clocks = <0x3d 0x0 0x3d 0x5 0x3d 0x6 0x3d 0x4 0x3d 0x1 0x3d 0x2 0x3d 0x3 0x3d 0x7 0x21 0x2b 0x21 0x33 0x12 0x5f 0x12 0x60 0x12 0x3 0x12 0x61 0x12 0x29 0x12 0x62 0x12 0x2c 0x12 0x82 0x12 0x83 0x12 0x84 0x12 0x85 0x12 0x70 0x12 0x71 0x12 0x72 0x12 0x73 0x3c 0x8 0x13>;
		clock-names = "aud_afe_clk", "aud_dac_clk", "aud_dac_predis_clk", "aud_adc_clk", "aud_apll22m_clk", "aud_apll24m_clk", "aud_apll1_tuner_clk", "aud_tml_clk", "aud_infra_axi_clk", "aud_infra_26m_clk", "top_mux_audio", "top_mux_audio_int", "top_sys_pll1_d4", "top_mux_aud_1", "top_apll1_ck", "top_mux_aud_eng1", "top_apll1_d8", "top_i2s0_m_sel", "top_i2s1_m_sel", "top_i2s2_m_sel", "top_i2s3_m_sel", "top_apll12_div0", "top_apll12_div1", "top_apll12_div2", "top_apll12_div3", "apmixed_apll1", "top_clk26m_clk";
		pinctrl-names = "aud_clk_mosi_off", "aud_clk_mosi_on", "aud_clk_miso_off", "aud_clk_miso_on", "aud_dat_mosi_off", "aud_dat_mosi_on", "aud_dat_miso_off", "aud_dat_miso_on", "aud_gpio_i2s0_off", "aud_gpio_i2s0_on", "aud_gpio_i2s1_off", "aud_gpio_i2s1_on", "aud_gpio_i2s2_off", "aud_gpio_i2s2_on", "aud_gpio_i2s3_off", "aud_gpio_i2s3_on", "vow_dat_miso_off", "vow_dat_miso_on", "vow_clk_miso_off", "vow_clk_miso_on";
		pinctrl-0 = <0x3e>;
		pinctrl-1 = <0x3f>;
		pinctrl-2 = <0x40>;
		pinctrl-3 = <0x41>;
		pinctrl-4 = <0x42>;
		pinctrl-5 = <0x43>;
		pinctrl-6 = <0x44>;
		pinctrl-7 = <0x45>;
		pinctrl-8 = <0x46>;
		pinctrl-9 = <0x47>;
		pinctrl-10 = <0x48>;
		pinctrl-11 = <0x49>;
		pinctrl-12 = <0x4a>;
		pinctrl-13 = <0x4b>;
		pinctrl-14 = <0x4c>;
		pinctrl-15 = <0x4d>;
		pinctrl-16 = <0x4e>;
		pinctrl-17 = <0x4f>;
		pinctrl-18 = <0x50>;
		pinctrl-19 = <0x51>;
		phandle = <0x53>;
	};

	mt6358_snd {
		compatible = "mediatek,mt6358-sound";
		mediatek,pwrap-regmap = <0x20>;
		phandle = <0x52>;
	};

	sound {
		compatible = "mediatek,mt6768-mt6358-sound";
		mediatek,audio-codec = <0x52>;
		mediatek,platform = <0x53>;
		mtk_spk_i2s_out = <0x3>;
		mtk_spk_i2s_in = <0x0>;
		phandle = <0xc6>;
	};

	snd_scp_spk {
		compatible = "mediatek,snd_scp_spk";
		phandle = <0xc7>;
	};

	audio_sram@11221000 {
		compatible = "mediatek,audio_sram";
		reg = <0x0 0x11221000 0x0 0x9000>;
		prefer_mode = <0x1>;
		mode_size = <0x6c00 0x9000>;
		block_size = <0x1000>;
	};

	mtk-btcvsd-snd@18050000 {
		compatible = "mediatek,mtk-btcvsd-snd";
		reg = <0x0 0x18050000 0x0 0x1000 0x0 0x18080000 0x0 0x10000>;
		interrupts = <0x0 0x11b 0x8>;
		mediatek,infracfg = <0x21>;
		mediatek,offset = <0xf00 0x800 0x140 0x144 0x148>;
	};

	mt_soc_playback_offload {
		compatible = "mediatek,mt_soc_offload_common";
	};

	mipi_rx_ana_csi0a@11c10000 {
		compatible = "mediatek,mipi_rx_ana_csi0a", "syscon";
		reg = <0x0 0x11c10000 0x0 0x1000>;
		#clock-cells = <0x1>;
		phandle = <0x5d>;
	};

	mipi_rx_ana_csi0b@11c11000 {
		compatible = "mediatek,mipi_rx_ana_csi0b", "syscon";
		reg = <0x0 0x11c11000 0x0 0x1000>;
		#clock-cells = <0x1>;
		phandle = <0x5e>;
	};

	mipi_rx_ana_csi1a@11c12000 {
		compatible = "mediatek,mipi_rx_ana_csi1a", "syscon";
		reg = <0x0 0x11c12000 0x0 0x1000>;
		#clock-cells = <0x1>;
		phandle = <0x5f>;
	};

	mipi_rx_ana_csi1b@11c13000 {
		compatible = "mediatek,mipi_rx_ana_csi1b", "syscon";
		reg = <0x0 0x11c13000 0x0 0x1000>;
		#clock-cells = <0x1>;
		phandle = <0x60>;
	};

	mipi_rx_ana_csi2a@11c14000 {
		compatible = "mediatek,mipi_rx_ana_csi2a", "syscon";
		reg = <0x0 0x11c14000 0x0 0x1000>;
		#clock-cells = <0x1>;
		phandle = <0x61>;
	};

	mipi_rx_ana_csi2b@11c15000 {
		compatible = "mediatek,mipi_rx_ana_csi2b", "syscon";
		reg = <0x0 0x11c15000 0x0 0x1000>;
		#clock-cells = <0x1>;
		phandle = <0x62>;
	};

	mipi_tx0@11c80000 {
		compatible = "mediatek,mipi_tx0";
		reg = <0x0 0x11c80000 0x0 0x10000>;
	};

	efusec@11ce0000 {
		compatible = "mediatek,efusec";
		reg = <0x0 0x11ce0000 0x0 0x10000>;
	};

	mfg_cfg@13000000 {
		compatible = "mediatek,mfgcfg", "syscon";
		reg = <0x0 0x13000000 0x0 0x1000>;
		#clock-cells = <0x1>;
		phandle = <0x54>;
	};

	mali@13040000 {
		compatible = "mediatek,mali", "arm,mali-midgard", "arm,mali-bifrost";
		reg = <0x0 0x13040000 0x0 0x4000>;
		interrupts = <0x0 0x112 0x8 0x0 0x113 0x8 0x0 0x114 0x8 0x0 0x115 0x8 0x0 0x116 0x8>;
		interrupt-names = "GPU", "MMU", "JOB", "EVENT", "PWR";
	};

	gpufreq {
		compatible = "mediatek,mt6768-gpufreq";
		clocks = <0x12 0x54 0x12 0x26 0x12 0x6 0x54 0x0 0x22 0x9 0x22 0x4 0x22 0x7 0x22 0x8>;
		clock-names = "clk_mux", "clk_main_parent", "clk_sub_parent", "subsys_mfg_cg", "mtcmos_mfg_async", "mtcmos_mfg", "mtcmos_mfg_core0", "mtcmos_mfg_core1";
	};

	mmsys_config@14000000 {
		compatible = "mediatek,mmsys_config", "syscon";
		reg = <0x0 0x14000000 0x0 0x1000>;
		interrupts = <0x0 0xf0 0x8>;
		#clock-cells = <0x1>;
		clocks = <0x24 0x17 0x24 0x1c 0x24 0x1d>;
		clock-names = "CAM_MDP", "IMG_DL_RELAY", "IMG_DL_ASYNC_TOP";
		phandle = <0x24>;
	};

	disp_mutex0@14001000 {
		compatible = "mediatek,disp_mutex0";
		reg = <0x0 0x14001000 0x0 0x1000>;
		interrupts = <0x0 0xdf 0x8>;
		phandle = <0x2d>;
	};

	smi_common@14002000 {
		compatible = "mediatek,smi_common";
		reg = <0x0 0x14002000 0x0 0x1000>;
		mediatek,smi-id = <0x5>;
		clocks = <0x22 0x3 0x24 0x15 0x24 0x16 0x24 0x13>;
		clock-names = "scp-dis", "mm-comm0", "mm-comm1", "mm-common";
		mmsys_config = <0x24>;
	};

	mmdvfs_pmqos {
		compatible = "mediatek,mmdvfs_pmqos";
		mm_step0 = <0x1c9 0x1 0x0 0x3>;
		mm_step1 = <0x138 0x1 0x0 0x4>;
		mm_step2 = <0xe4 0x1 0x0 0x5>;
		venc_step0 = <0x1c9 0x1 0x1 0x3>;
		venc_step1 = <0x1a0 0x1 0x1 0x6>;
		venc_step2 = <0x138 0x1 0x1 0x4>;
		cam_step0 = <0x222 0x1 0x2 0x7>;
		cam_step1 = <0x138 0x1 0x2 0x4>;
		cam_step2 = <0xe4 0x1 0x2 0x5>;
		vopp_steps = <0x0 0x1 0x3>;
		disp_freq = "mm_step0", "mm_step1", "mm_step2";
		mdp_freq = "mm_step0", "mm_step1", "mm_step2";
		cam_freq = "cam_step0", "cam_step1", "cam_step2";
		img_freq = "mm_step0", "mm_step1", "mm_step2";
		vdec_freq = "mm_step0", "mm_step1", "mm_step2";
		venc_freq = "venc_step0", "venc_step1", "venc_step2";
		clocks = <0x12 0x52 0x12 0x6e 0x12 0x6f 0x12 0x21 0x12 0x17 0x12 0x22 0x12 0x19 0x12 0x1>;
		clock-names = "mmdvfs_clk_mm_sel_ck", "mmdvfs_clk_venc_sel_ck", "mmdvfs_clk_cam_sel_ck", "mmdvfs_clk_mmpll_ck", "mmdvfs_clk_univpll1_d2_ck", "mmdvfs_clk_mmpll_d2_ck", "mmdvfs_clk_univpll_d3_ck", "mmdvfs_clk_syspll_d2_ck";
	};

	smi_larb0@14003000 {
		compatible = "mediatek,smi_larb0", "mediatek,smi_larb";
		reg = <0x0 0x14003000 0x0 0x1000>;
		mediatek,smi-id = <0x0>;
		clocks = <0x22 0x3 0x24 0x14>;
		clock-names = "scp-dis", "mm-larb0";
		phandle = <0x55>;
	};

	mdp_rdma0@14004000 {
		compatible = "mediatek,mdp_rdma0";
		reg = <0x0 0x14004000 0x0 0x1000>;
		interrupts = <0x0 0xe0 0x8>;
		clocks = <0x24 0x0>;
		clock-names = "MDP_RDMA0";
		phandle = <0x25>;
	};

	mdp_ccorr0@14005000 {
		compatible = "mediatek,mdp_ccorr0";
		reg = <0x0 0x14005000 0x0 0x1000>;
		interrupts = <0x0 0xef 0x8>;
		clocks = <0x24 0x1>;
		clock-names = "MDP_CCORR";
		phandle = <0x2c>;
	};

	mdp_rsz0@14006000 {
		compatible = "mediatek,mdp_rsz0";
		reg = <0x0 0x14006000 0x0 0x1000>;
		interrupts = <0x0 0xe1 0x8>;
		clocks = <0x24 0x2>;
		clock-names = "MDP_RSZ0";
		phandle = <0x26>;
	};

	mdp_rsz1@14007000 {
		compatible = "mediatek,mdp_rsz1";
		reg = <0x0 0x14007000 0x0 0x1000>;
		interrupts = <0x0 0xe2 0x8>;
		clocks = <0x24 0x3>;
		clock-names = "MDP_RSZ1";
		phandle = <0x27>;
	};

	mdp_wdma0@14008000 {
		compatible = "mediatek,mdp_wdma0";
		reg = <0x0 0x14008000 0x0 0x1000>;
		interrupts = <0x0 0xe5 0x8>;
		clocks = <0x24 0x6>;
		clock-names = "MDP_WDMA";
		phandle = <0x28>;
	};

	mdp_wrot0@14009000 {
		compatible = "mediatek,mdp_wrot0";
		reg = <0x0 0x14009000 0x0 0x1000>;
		interrupts = <0x0 0xe4 0x8>;
		clocks = <0x24 0x5>;
		clock-names = "MDP_WROT0";
		phandle = <0x29>;
	};

	mdp_tdshp0@1400a000 {
		compatible = "mediatek,mdp_tdshp0";
		reg = <0x0 0x1400a000 0x0 0x1000>;
		clocks = <0x24 0x4>;
		clock-names = "MDP_TDSHP";
		phandle = <0x2a>;
	};

	disp_ovl0@1400b000 {
		compatible = "mediatek,disp_ovl0";
		reg = <0x0 0x1400b000 0x0 0x1000>;
		interrupts = <0x0 0xe6 0x8>;
	};

	disp_rdma0@1400d000 {
		compatible = "mediatek,disp_rdma0";
		reg = <0x0 0x1400d000 0x0 0x1000>;
		interrupts = <0x0 0xe7 0x8>;
	};

	disp_wdma0@1400e000 {
		compatible = "mediatek,disp_wdma0";
		reg = <0x0 0x1400e000 0x0 0x1000>;
		interrupts = <0x0 0xe8 0x8>;
	};

	disp_color0@1400f000 {
		compatible = "mediatek,disp_color0";
		reg = <0x0 0x1400f000 0x0 0x1000>;
		interrupts = <0x0 0xe9 0x8>;
		clocks = <0x24 0xc>;
		clock-names = "MDP_COLOR";
		phandle = <0x2b>;
	};

	disp_ccorr0@14010000 {
		compatible = "mediatek,disp_ccorr0";
		reg = <0x0 0x14010000 0x0 0x1000>;
		interrupts = <0x0 0xea 0x8>;
	};

	disp_aal0@14011000 {
		compatible = "mediatek,disp_aal0";
		reg = <0x0 0x14011000 0x0 0x1000>;
		interrupts = <0x0 0xeb 0x8>;
	};

	disp_gamma0@14012000 {
		compatible = "mediatek,disp_gamma0";
		reg = <0x0 0x14012000 0x0 0x1000>;
		interrupts = <0x0 0xec 0x8>;
	};

	disp_dither0@14013000 {
		compatible = "mediatek,disp_dither0";
		reg = <0x0 0x14013000 0x0 0x1000>;
		interrupts = <0x0 0xed 0x8>;
	};

	dsi0@14014000 {
		compatible = "mediatek,dsi0";
		reg = <0x0 0x14014000 0x0 0x1000>;
		interrupts = <0x0 0xee 0x8>;
	};

	disp_ovl0_2l@1400c000 {
		compatible = "mediatek,disp_ovl0_2l";
		reg = <0x0 0x1400c000 0x0 0x1000>;
		interrupts = <0x0 0xf2 0x8>;
	};

	disp_rsz0@14015000 {
		compatible = "mediatek,disp_rsz0";
		reg = <0x0 0x14015000 0x0 0x1000>;
		interrupts = <0x0 0x125 0x8>;
	};

	mtkfb@0 {
		compatible = "mediatek,mtkfb";
		phandle = <0xc8>;
	};

	dispsys {
		compatible = "mediatek,dispsys";
		mediatek,larb = <0x55>;
		clocks = <0x22 0x3 0x24 0x13 0x24 0x14 0x24 0x15 0x24 0x16 0x24 0x7 0x24 0x8 0x24 0xa 0x24 0xb 0x24 0xc 0x24 0xd 0x24 0xe 0x24 0xf 0x24 0x10 0x24 0x11 0x24 0x1e 0x24 0x1c 0x24 0x1f 0x24 0x9 0x3c 0x15 0x12 0x63 0x21 0x31 0x13 0x12 0x1b 0x12 0x2e 0x12 0x30>;
		clock-names = "MMSYS_MTCMOS", "MMSYS_SMI_COMMON", "MMSYS_SMI_LARB0", "MMSYS_GALS_COMM0", "MMSYS_GALS_COMM1", "MMSYS_DISP_OVL0", "MMSYS_DISP_OVL0_2L", "MMSYS_DISP_RDMA0", "MMSYS_DISP_WDMA0", "MMSYS_DISP_COLOR0", "MMSYS_DISP_CCORR0", "MMSYS_DISP_AAL0", "MMSYS_DISP_GAMMA0", "MMSYS_DISP_DITHER0", "MMSYS_DSI0_MM_CK", "MMSYS_DSI0_IF_CK", "MMSYS_IMG_DL_RELAY", "MMSYS_26M", "MMSYS_DISP_RSZ0", "APMIXED_MIPI_26M", "TOP_MUX_DISP_PWM", "DISP_PWM", "TOP_26M", "TOP_UNIVPLL2_D4", "TOP_ULPOSC1_D2", "TOP_ULPOSC1_D8";
	};

	dsi_te {
		compatible = "mediatek, dsi_te-eint";
		status = "disabled";
		phandle = <0xc9>;
	};

	mm_mutex@14016000 {
		compatible = "mediatek,mm_mutex";
		reg = <0x0 0x14016000 0x0 0x1000>;
	};

	imgsys@15020000 {
		compatible = "mediatek,imgsys", "syscon";
		reg = <0x0 0x15020000 0x0 0x1000>;
		#clock-cells = <0x1>;
		clocks = <0x22 0x3 0x22 0x5 0x22 0xa 0x56 0x1 0x57 0x2 0x57 0x3 0x57 0x4 0x57 0x5 0x57 0x6 0x57 0x7>;
		clock-names = "ISP_SCP_SYS_DIS", "ISP_SCP_SYS_ISP", "ISP_SCP_SYS_CAM", "ISP_CLK_IMG_DIP", "ISP_CLK_CAM", "ISP_CLK_CAMTG", "ISP_CLK_CAM_SENINF", "ISP_CLK_CAMSV0", "ISP_CLK_CAMSV1", "ISP_CLK_CAMSV2";
		phandle = <0x56>;
	};

	dip1@15022000 {
		compatible = "mediatek,dip1";
		reg = <0x0 0x15022000 0x0 0x3000>;
		interrupts = <0x0 0x10e 0x8>;
	};

	fdvt@1502b000 {
		compatible = "mediatek,fdvt";
		reg = <0x0 0x1502b000 0x0 0x1000>;
		interrupts = <0x0 0x111 0x8>;
		clocks = <0x56 0x2>;
		clock-names = "FD_CLK_IMG_FDVT";
	};

	dpe@15028000 {
		compatible = "mediatek,dpe";
		reg = <0x0 0x15028000 0x0 0x1000>;
		interrupts = <0x0 0x10f 0x8>;
		clocks = <0x56 0x3>;
		clock-names = "DPE_CG_IMG_DPE";
	};

	smi_larb2@15021000 {
		compatible = "mediatek,smi_larb2", "mediatek,smi_larb";
		reg = <0x0 0x15021000 0x0 0x1000>;
		mediatek,smi-id = <0x2>;
		clocks = <0x22 0x5 0x24 0x18 0x56 0x0>;
		clock-names = "scp-isp", "mm-img", "img-larb2";
		phandle = <0xca>;
	};

	vcu@16000000 {
		compatible = "mediatek-vcu";
		mediatek,vcuid = <0x0>;
		mediatek,vcuname = "vcu";
		reg = <0x0 0x16000000 0x0 0x40000 0x0 0x17020000 0x0 0x10000 0x0 0x19002000 0x0 0x1000>;
		mediatek,mailbox-gce = <0x2e>;
		mboxes = <0x2e 0x1 0x0 0x1 0x2e 0x5 0x0 0x1>;
		gce-event-names = "venc_eof", "venc_cmdq_pause_done", "venc_mb_done", "venc_128B_cnt_done";
		gce-events = <0x2e 0x121 0x2e 0x122 0x2e 0x124 0x2e 0x125>;
		phandle = <0x59>;
	};

	vdec_gcon@16000000 {
		compatible = "mediatek,vdec_gcon", "syscon";
		reg = <0x0 0x16000000 0x0 0x1000 0x0 0x16020000 0x0 0x400 0x0 0x16025000 0x0 0x1000>;
		mediatek,larb = <0x58>;
		interrupts = <0x0 0xf6 0x8>;
		mediatek,vcu = <0x59>;
		clocks = <0x22 0x3 0x22 0xc 0x5a 0x0>;
		clock-names = "MT_SCP_SYS_DIS", "MT_SCP_SYS_VDE", "MT_CG_VDEC";
		#clock-cells = <0x1>;
		phandle = <0x5a>;
	};

	smi_larb1@16010000 {
		compatible = "mediatek,smi_larb1", "mediatek,smi_larb";
		reg = <0x0 0x16010000 0x0 0x1000>;
		interrupts = <0x0 0xf7 0x8>;
		mediatek,smi-id = <0x1>;
		clocks = <0x22 0xc 0x24 0x1b 0x5a 0x3>;
		clock-names = "scp-vdec", "mm-vdec", "vdec-larb1";
		phandle = <0x58>;
	};

	vdec@16020000 {
		compatible = "mediatek,vdec";
		reg = <0x0 0x16020000 0x0 0x10000>;
		interrupts = <0x0 0xf6 0x8>;
	};

	reserve@16030000 {
		compatible = "mediatek,reserve";
		reg = <0x0 0x16030000 0x0 0x10000>;
	};

	vdec_mbist_ctrl@16001000 {
		compatible = "mediatek,vdec_mbist_ctrl";
		reg = <0x0 0x16001000 0x0 0x1000>;
	};

	venc_gcon@17000000 {
		compatible = "mediatek,venc_gcon", "syscon";
		reg = <0x0 0x17000000 0x0 0x1000 0x0 0x17020000 0x0 0x1000>;
		mediatek,larb = <0x5b>;
		interrupts = <0x0 0xf3 0x8>;
		mediatek,vcu = <0x59>;
		clocks = <0x22 0x3 0x22 0xb 0x5c 0x1>;
		clock-names = "MT_SCP_SYS_DIS", "MT_SCP_SYS_VEN", "MT_CG_VENC";
		#clock-cells = <0x1>;
		phandle = <0x5c>;
	};

	smi_larb4@17010000 {
		compatible = "mediatek,smi_larb4", "mediatek,smi_larb";
		reg = <0x0 0x17010000 0x0 0x1000>;
		mediatek,smi-id = <0x4>;
		clocks = <0x22 0xb 0x24 0x1a 0x5c 0x1 0x5c 0x2>;
		clock-names = "scp-venc", "mm-venc", "venc-venc", "venc-jpgenc";
		phandle = <0x5b>;
	};

	venc@17020000 {
		compatible = "mediatek,venc";
		reg = <0x0 0x17020000 0x0 0x10000>;
		interrupts = <0x0 0xf3 0x8>;
	};

	venc_jpg@17030000 {
		compatible = "mediatek,venc_jpg";
		reg = <0x0 0x17030000 0x0 0x10000>;
		interrupts = <0x0 0xf5 0x8>;
		clocks = <0x5c 0x2>;
		clock-names = "MT_CG_VENC_JPGENC";
	};

	mbist@17040000 {
		compatible = "mediatek,mbist";
		reg = <0x0 0x17040000 0x0 0x10000>;
	};

	mbist@17050000 {
		compatible = "mediatek,mbist";
		reg = <0x0 0x17050000 0x0 0x10000>;
	};

	mbist@17060000 {
		compatible = "mediatek,mbist";
		reg = <0x0 0x17060000 0x0 0x10000>;
	};

	mbist@17070000 {
		compatible = "mediatek,mbist";
		reg = <0x0 0x17070000 0x0 0x10000>;
	};

	wifi@18000000 {
		compatible = "mediatek,wifi";
		reg = <0x0 0x18000000 0x0 0x100000>;
		interrupts = <0x0 0x11d 0x8>;
	};

	camsys@1a000000 {
		compatible = "mediatek,camsys", "syscon";
		reg = <0x0 0x1a000000 0x0 0x1000>;
		#clock-cells = <0x1>;
		phandle = <0x57>;
	};

	smi_larb3@1a002000 {
		compatible = "mediatek,smi_larb3", "mediatek,smi_larb";
		reg = <0x0 0x1a002000 0x0 0x1000>;
		mediatek,smi-id = <0x3>;
		clocks = <0x22 0xa 0x24 0x19 0x57 0x0>;
		clock-names = "scp-cam", "mm-cam", "cam-larb3";
		phandle = <0xcb>;
	};

	cam1@1a003000 {
		compatible = "mediatek,cam1";
		reg = <0x0 0x1a003000 0x0 0x1000>;
		interrupts = <0x0 0xfa 0x8>;
	};

	cam2@1a004000 {
		compatible = "mediatek,cam2";
		reg = <0x0 0x1a004000 0x0 0x1000>;
		interrupts = <0x0 0xfb 0x8>;
	};

	cam3@1a005000 {
		compatible = "mediatek,cam3";
		reg = <0x0 0x1a005000 0x0 0x1000>;
		interrupts = <0x0 0xfc 0x8>;
	};

	cam_set@1a00b000 {
		compatible = "mediatek,cam_set";
		reg = <0x0 0x1a00b000 0x0 0x1000>;
	};

	cama_set@1a00c000 {
		compatible = "mediatek,cama_set";
		reg = <0x0 0x1a00c000 0x0 0x1000>;
	};

	camb_set@1a00d000 {
		compatible = "mediatek,camb_set";
		reg = <0x0 0x1a00d000 0x0 0x1000>;
	};

	cam_inner@1a013000 {
		compatible = "mediatek,cam_inner";
		reg = <0x0 0x1a013000 0x0 0x1000>;
	};

	cama_inner@1a014000 {
		compatible = "mediatek,cama_inner";
		reg = <0x0 0x1a014000 0x0 0x1000>;
	};

	camb_inner@1a015000 {
		compatible = "mediatek,camb_inner";
		reg = <0x0 0x1a015000 0x0 0x1000>;
	};

	cam_clear@1a01b000 {
		compatible = "mediatek,cam_clear";
		reg = <0x0 0x1a01b000 0x0 0x1000>;
	};

	cama_clear@1a01c000 {
		compatible = "mediatek,cama_clear";
		reg = <0x0 0x1a01c000 0x0 0x1000>;
	};

	camb_clear@1a01d000 {
		compatible = "mediatek,camb_clear";
		reg = <0x0 0x1a01d000 0x0 0x1000>;
	};

	cama_ext@1a024000 {
		compatible = "mediatek,cama_ext";
		reg = <0x0 0x1a024000 0x0 0x1000>;
	};

	camb_ext@1a025000 {
		compatible = "mediatek,camb_ext";
		reg = <0x0 0x1a025000 0x0 0x1000>;
	};

	seninf1@1a040000 {
		compatible = "mediatek,seninf1";
		reg = <0x0 0x1a040000 0x0 0x1000>;
	};

	seninf2@1a041000 {
		compatible = "mediatek,seninf2";
		reg = <0x0 0x1a041000 0x0 0x1000>;
	};

	seninf3@1a042000 {
		compatible = "mediatek,seninf3";
		reg = <0x0 0x1a042000 0x0 0x1000>;
	};

	seninf4@1a043000 {
		compatible = "mediatek,seninf4";
		reg = <0x0 0x1a043000 0x0 0x1000>;
	};

	kd_camera_hw1@1a040000 {
		compatible = "mediatek,camera_hw";
		reg = <0x0 0x1a040000 0x0 0x1000>;
		clocks = <0x12 0x56 0x12 0x57 0x12 0x58 0x12 0x59 0x12 0x14 0x12 0x13 0x12 0x1d 0x12 0x11 0x12 0x1c 0x12 0x12 0x13 0x57 0x4 0x3c 0xe 0x3c 0x12 0x5d 0x0 0x5e 0x0 0x5f 0x0 0x60 0x0 0x61 0x0 0x62 0x0 0x12 0x6d 0x12 0x1a 0x22 0xa>;
		clock-names = "CLK_TOP_CAMTG_SEL", "CLK_TOP_CAMTG1_SEL", "CLK_TOP_CAMTG2_SEL", "CLK_TOP_CAMTG3_SEL", "CLK_MCLK_6M", "CLK_MCLK_12M", "CLK_MCLK_13M", "CLK_MCLK_48M", "CLK_MCLK_52M", "CLK_MCLK_24M", "CLK_MCLK_26M", "CLK_CAM_SENINF_CG", "CLK_MIPI_C0_26M_CG", "CLK_MIPI_C1_26M_CG", "CLK_MIPI_ANA_0A_CG", "CLK_MIPI_ANA_0B_CG", "CLK_MIPI_ANA_1A_CG", "CLK_MIPI_ANA_1B_CG", "CLK_MIPI_ANA_2A_CG", "CLK_MIPI_ANA_2B_CG", "CLK_TOP_CAMTM_SEL_CG", "CLK_TOP_CAMTM_208_CG", "CLK_SCP_SYS_CAM";
		phandle = <0xcc>;
	};

	flashlight_core {
		compatible = "mediatek,flashlight_core";
		phandle = <0xcd>;
	};

	flashlights_mt6370 {
		compatible = "mediatek,flashlights_mt6370";
		decouple = <0x0>;
		phandle = <0xce>;

		channel@1 {
			type = <0x0>;
			ct = <0x0>;
			part = <0x0>;
		};

		channel@2 {
			type = <0x0>;
			ct = <0x1>;
			part = <0x0>;
		};
	};

	flashlights_aw36518 {
		compatible = "mediatek,flashlights_aw36518";
		decouple = <0x1>;
		phandle = <0xcf>;

		channel@1 {
			type = <0x0>;
			ct = <0x0>;
			part = <0x0>;
		};

		channel@2 {
			type = <0x0>;
			ct = <0x1>;
			part = <0x0>;
		};
	};

	camsv1@1a050000 {
		compatible = "mediatek,camsv1";
		reg = <0x0 0x1a050000 0x0 0x1000>;
		interrupts = <0x0 0x102 0x8>;
	};

	camsv2@1a051000 {
		compatible = "mediatek,camsv2";
		reg = <0x0 0x1a051000 0x0 0x1000>;
		interrupts = <0x0 0x103 0x8>;
	};

	camsv3@1a052000 {
		compatible = "mediatek,camsv3";
		reg = <0x0 0x1a052000 0x0 0x1000>;
		interrupts = <0x0 0x100 0x8>;
	};

	camsv4@1a053000 {
		compatible = "mediatek,camsv4";
		reg = <0x0 0x1a053000 0x0 0x1000>;
		interrupts = <0x0 0x101 0x8>;
	};

	ccu@1a0b1000 {
		compatible = "mediatek,ccu";
		reg = <0x0 0x1a0b1000 0x0 0x10000>;
		interrupts = <0x0 0x105 0x8>;
		clocks = <0x57 0x8 0x22 0xa>;
		clock-names = "CCU_CLK_CAM_CCU", "CAM_PWR";
	};

	atf_logger {
		compatible = "mediatek,atf_logger";
		interrupts = <0x0 0x128 0x1>;
	};

	amms_control {
		compatible = "mediatek,amms";
		interrupts = <0x0 0x131 0x1>;
	};

	odm {
		compatible = "simple-bus";
		phandle = <0xd0>;
	};

	memory-ssmr-features {
		compatible = "mediatek,memory-ssmr-features";
		svp-size = <0x0 0x10000000>;
		iris-recognition-size = <0x0 0x10000000>;
		2d_fr-size = <0x0 0x8000000>;
		tui-size = <0x0 0x4000000>;
		wfd-size = <0x0 0x4000000>;
		prot-sharedmem-size = <0x0 0x8000000>;
		ta-elf-size = <0x0 0x1000000>;
		ta-stack-heap-size = <0x0 0x6000000>;
		sdsp-tee-sharedmem-size = <0x0 0x1000000>;
		sdsp-firmware-size = <0x0 0x1000000>;
		phandle = <0xd1>;
	};

	radio_md_cfg {
		compatible = "mediatek,radio_md_cfg";
		phandle = <0xd2>;
	};

	mt_charger {
		compatible = "mediatek,mt-charger";
		phandle = <0xd3>;
	};

	lk_charger {
		compatible = "mediatek,lk_charger";
		enable_anime;
		enable_pd20_reset;
		power_path_support;
		max_charger_voltage = <0x90f560>;
		fast_charge_voltage = <0x2dc6c0>;
		usb_charger_current = <0x7a120>;
		ac_charger_current = <0x1f47d0>;
		ac_charger_input_current = <0x30d400>;
		non_std_ac_charger_current = <0x7a120>;
		charging_host_charger_current = <0x16e360>;
		ta_ac_charger_current = <0x2dc6c0>;
		pd_charger_current = <0x7a120>;
		temp_t4_threshold = <0x32>;
		temp_t3_threshold = <0x2d>;
		temp_t1_threshold = <0x0>;
		enable_pe_plus;
		phandle = <0xd4>;
	};

	charger {
		compatible = "mediatek,charger";
		algorithm_name = "DualSwitchCharging";
		enable_type_c;
		power_path_support;
		enable_dynamic_mivr;
		disable_pd_dual;
		battery_cv = <0x432380>;
		max_charger_voltage = <0x90f560>;
		min_charger_voltage = <0x432380>;
		min_charger_voltage_1 = <0x432380>;
		min_charger_voltage_2 = <0x401640>;
		max_dmivr_charger_current = <0x155cc0>;
		usb_charger_current_suspend = <0x0>;
		usb_charger_current_unconfigured = <0x11170>;
		usb_charger_current_configured = <0x7a120>;
		usb_charger_current = <0x7a120>;
		ac_charger_current = <0x1f47d0>;
		ac_charger_input_current = <0x30d400>;
		non_std_ac_charger_current = <0x7a120>;
		charging_host_charger_current = <0x16e360>;
		apple_1_0a_charger_current = <0x9eb10>;
		apple_2_1a_charger_current = <0xc3500>;
		ta_ac_charger_current = <0x2dc6c0>;
		jeita_temp_above_t4_cv = <0x40b280>;
		jeita_temp_t3_to_t4_cv = <0x40b280>;
		jeita_temp_t2_to_t3_cv = <0x423920>;
		jeita_temp_t1_to_t2_cv = <0x40b280>;
		jeita_temp_t0_to_t1_cv = <0x3da540>;
		jeita_temp_below_t0_cv = <0x3da540>;
		temp_t4_thres = <0x32>;
		temp_t4_thres_minus_x_degree = <0x2f>;
		temp_t3_thres = <0x2d>;
		temp_t3_thres_minus_x_degree = <0x27>;
		temp_t2_thres = <0xa>;
		temp_t2_thres_plus_x_degree = <0x10>;
		temp_t1_thres = <0x0>;
		temp_t1_thres_plus_x_degree = <0x6>;
		temp_t0_thres = <0x0>;
		temp_t0_thres_plus_x_degree = <0x0>;
		temp_neg_10_thres = <0x0>;
		enable_min_charge_temp;
		min_charge_temp = <0xfffffffb>;
		min_charge_temp_plus_x_degree = <0x0>;
		max_charge_temp = <0x37>;
		max_charge_temp_minus_x_degree = <0x32>;
		ta_9v_support;
		pe_ichg_level_threshold = <0xf4240>;
		ta_ac_9v_input_current = <0x30d400>;
		ta_ac_7v_input_current = <0x30d400>;
		pe20_ichg_level_threshold = <0xf4240>;
		ta_start_battery_soc = <0x0>;
		ta_stop_battery_soc = <0x55>;
		high_temp_to_leave_pe40 = <0x2e>;
		high_temp_to_enter_pe40 = <0x27>;
		low_temp_to_leave_pe40 = <0xa>;
		low_temp_to_enter_pe40 = <0x10>;
		pe40_single_charger_input_current = <0x2dc6c0>;
		pe40_single_charger_current = <0x2dc6c0>;
		pe40_dual_charger_input_current = <0x2dc6c0>;
		pe40_dual_charger_chg1_current = <0x1e8480>;
		pe40_dual_charger_chg2_current = <0x1e8480>;
		pe40_stop_battery_soc = <0x50>;
		pe40_r_cable_1a_lower = <0x206>;
		pe40_r_cable_2a_lower = <0x17f>;
		pe40_r_cable_3a_lower = <0xf5>;
		chg1_ta_ac_charger_current = <0x19f0a0>;
		chg2_ta_ac_charger_current = <0x1b7740>;
		slave_mivr_diff = <0x186a0>;
		dual_polling_ieoc = <0x3d090>;
		cable_imp_threshold = <0x2bb>;
		vbat_cable_imp_threshold = <0x3b8260>;
		bif_threshold1 = <0x40d990>;
		bif_threshold2 = <0x419ce0>;
		bif_cv_under_threshold2 = <0x43e6d0>;
		pd_vbus_low_bound = <0x4c4b40>;
		pd_vbus_upper_bound = <0x4c4b40>;
		pd_ichg_level_threshold = <0xf4240>;
		pd_stop_battery_soc = <0x50>;
		ibus_err = <0xe>;
		vsys_watt = <0x4c4b40>;
		enable_pe_plus;
		enable_pe_2;
		enable_pe_3;
		parallel_vbus;
		phandle = <0xd5>;
	};

	pd_adapter {
		compatible = "mediatek,pd_adapter";
		adapter_name = "pd_adapter";
		phandle = <0xd6>;
	};

	rt9465_slave_chr {
		compatible = "richtek,rt9465";
		phandle = <0xd7>;
	};

	rt-pd-manager {
		compatible = "mediatek,rt-pd-manager";
	};

	mt6370_pmu_eint {
		phandle = <0xd8>;
	};

	tcpc_pd_eint {
		phandle = <0xd9>;
	};

	irtx_pwm {
		compatible = "mediatek,irtx-pwm";
		pwm_ch = <0x0>;
		pwm_data_invert = <0x0>;
		phandle = <0xda>;
	};

	pmic_clock_buffer_ctrl {
		compatible = "mediatek,pmic_clock_buffer";
		mediatek,clkbuf-quantity = <0x7>;
		mediatek,clkbuf-config = <0x2 0x1 0x1 0x2 0x0 0x0 0x0>;
		mediatek,clkbuf-driving-current = <0x1 0x1 0x1 0x1 0x1 0x1 0x1>;
		phandle = <0xdb>;
	};

	touch {
		compatible = "mediatek,touch";
		phandle = <0xdc>;
	};

	nfc {
		compatible = "mediatek,nfc-gpio-v2";
		gpio-rst = <0x9f>;
		gpio-rst-std = <0x1e 0x9f 0x0>;
		gpio-irq = <0x9>;
		gpio-irq-std = <0x1e 0x9 0x0>;
		phandle = <0xdd>;
	};

	irq_nfc {
		compatible = "mediatek,irq_nfc-eint";
		phandle = <0xde>;
	};

	smart_pa {
		phandle = <0xdf>;
	};

	gpio {
		compatible = "mediatek,gpio_usage_mapping";
		phandle = <0xe0>;
	};

	md1_sim1_hot_plug_eint {
		phandle = <0xe1>;
	};

	md1_sim2_hot_plug_eint {
		phandle = <0xe2>;
	};

	prize_disp {
		compatible = "prize,dispsys_gpio";
		phandle = <0xe3>;
	};

	type_c_port0 {
		tcpc-dual,supported_modes = <0x0>;
		rt-tcpc,name = "type_c_port0";
		rt-tcpc,role_def = <0x4>;
		rt-tcpc,rp_level = <0x0>;
		rt-tcpc,vconn_supply = <0x1>;
		rt-tcpc,notifier_supply_num = <0x3>;
		rt1711pd,intr_gpio = <0x1e 0x29 0x0>;
		rt1711pd,intr_gpio_num = <0x29>;
		phandle = <0xe4>;

		pd-data {
			pd,vid = <0x29cf>;
			pd,pid = <0x5081>;
			pd,source-cap-ext = <0x171129cf 0x0 0x102 0x0 0x0 0x2000000>;
			pd,mfrs = "RichtekTCPC";
			pd,charging_policy = <0x21>;
			pd,source-pdo-size = <0x1>;
			pd,source-pdo-data = <0x19032>;
			pd,sink-pdo-size = <0x2>;
			pd,sink-pdo-data = <0x190c8 0xc0761e3c>;
			pd,id-vdo-size = <0x3>;
			pd,id-vdo-data = <0xd10029cf 0x0 0x10000>;
			bat,nr = <0x1>;
			pd,country_nr = <0x0>;

			bat-info0 {
				bat,vid = <0x29cf>;
				bat,pid = <0x1711>;
				bat,mfrs = "bat1";
				bat,design_cap = <0xbb8>;
			};
		};

		dpm_caps {
			local_dr_power;
			local_dr_data;
			local_usb_comm;
			local_no_suspend;
			local_vconn_supply;
			attemp_enter_dp_mode;
			attemp_discover_cable;
			attemp_discover_id;
			pr_check = <0x0>;
			pr_check_gp_source;
			dr_check = <0x0>;
		};
	};

	__symbols__ {
		chosen = "/chosen";
		cpu0 = "/cpus/cpu@000";
		cpu1 = "/cpus/cpu@001";
		cpu2 = "/cpus/cpu@002";
		cpu3 = "/cpus/cpu@003";
		cpu4 = "/cpus/cpu@100";
		cpu5 = "/cpus/cpu@101";
		cpu6 = "/cpus/cpu@102";
		cpu7 = "/cpus/cpu@103";
		doe_dvfs_cl0 = "/cpus/cpu-map/cluster0/doe";
		doe_dvfs_cl1 = "/cpus/cpu-map/cluster1/doe";
		STANDBY = "/cpus/idle-states/standby";
		MCDI_CPU = "/cpus/idle-states/mcdi-cpu";
		MCDI_CLUSTER = "/cpus/idle-states/mcdi-cluster";
		idledram = "/cpus/idle-states/idledram";
		idlesyspll = "/cpus/idle-states/idlesyspll";
		idlebus26m = "/cpus/idle-states/idlebus26m";
		SUSPEND = "/cpus/idle-states/suspend";
		reserved_memory = "/reserved-memory";
		cpu_dbgapb = "/cpu_dbgapb@0e010000";
		gic = "/interrupt-controller";
		sysirq = "/intpol-controller@0";
		timer = "/timer";
		infracfg_ao = "/infracfg_ao@10001000";
		scpsys = "/scpsys@10001000";
		mcdi = "/mcdi@0010fc00";
		topckgen = "/topckgen@10000000";
		io_cfg_lt = "/io_cfg_lt@10002000";
		io_cfg_lm = "/io_cfg_lm@10002200";
		io_cfg_lb = "/io_cfg_lb@10002400";
		io_cfg_bl = "/io_cfg_bl@10002600";
		io_cfg_rm = "/io_cfg_rm@10002800";
		io_cfg_rb = "/io_cfg_rb@10002a00";
		io_cfg_rt = "/io_cfg_rt@10002c00";
		io_cfg_tl = "/io_cfg_tl@10002e00";
		pericfg = "/pericfg@10003000";
		gpio = "/gpio@10005000";
		pio = "/pinctrl";
		aud_clk_mosi_off = "/pinctrl/aud_clk_mosi_off";
		aud_clk_mosi_on = "/pinctrl/aud_clk_mosi_on";
		aud_clk_miso_off = "/pinctrl/aud_clk_miso_off";
		aud_clk_miso_on = "/pinctrl/aud_clk_miso_on";
		aud_dat_mosi_off = "/pinctrl/aud_dat_mosi_off";
		aud_dat_mosi_on = "/pinctrl/aud_dat_mosi_on";
		aud_dat_miso_off = "/pinctrl/aud_dat_miso_off";
		aud_dat_miso_on = "/pinctrl/aud_dat_miso_on";
		aud_gpio_i2s0_off = "/pinctrl/aud_gpio_i2s0_off";
		aud_gpio_i2s0_on = "/pinctrl/aud_gpio_i2s0_on";
		aud_gpio_i2s1_off = "/pinctrl/aud_gpio_i2s1_off";
		aud_gpio_i2s1_on = "/pinctrl/aud_gpio_i2s1_on";
		aud_gpio_i2s2_off = "/pinctrl/aud_gpio_i2s2_off";
		aud_gpio_i2s2_on = "/pinctrl/aud_gpio_i2s2_on";
		aud_gpio_i2s3_off = "/pinctrl/aud_gpio_i2s3_off";
		aud_gpio_i2s3_on = "/pinctrl/aud_gpio_i2s3_on";
		vow_dat_miso_off = "/pinctrl/vow_dat_miso_off";
		vow_dat_miso_on = "/pinctrl/vow_dat_miso_on";
		vow_clk_miso_off = "/pinctrl/vow_clk_miso_off";
		vow_clk_miso_on = "/pinctrl/vow_clk_miso_on";
		lcm_power_gpio = "/pinctrl/lcm_power_gpio";
		msdc0_pins_default = "/pinctrl/msdc0@default";
		msdc0_pins_hs400 = "/pinctrl/msdc0@hs400";
		msdc0_pins_hs200 = "/pinctrl/msdc0@hs200";
		msdc0_register_setting_default = "/pinctrl/msdc0@register_default";
		msdc1_pins_default = "/pinctrl/msdc1@default";
		msdc1_pins_sdr104 = "/pinctrl/msdc1@sdr104";
		msdc1_pins_sdr50 = "/pinctrl/msdc1@sdr50";
		msdc1_pins_ddr50 = "/pinctrl/msdc1@ddr50";
		msdc1_register_setting_default = "/pinctrl/msdc1@register_default";
		sleep = "/sleep@10006000";
		toprgu = "/toprgu@10007000";
		clk26m = "/clocks/clk26m";
		clk32k = "/clocks/clk32k";
		dcm = "/dcm";
		eint = "/apirq@1000b000";
		apmixed = "/apmixed@1000c000";
		pwrap = "/pwrap@1000d000";
		main_pmic = "/pwrap@1000d000/mt6358-pmic";
		pmic = "/pwrap@1000d000/mt6358-pmic/mt-pmic";
		pmic_auxadc = "/pwrap@1000d000/mt6358-pmic/mt635x-auxadc";
		mt6358regulator = "/pwrap@1000d000/mt6358-pmic/mt6358regulator";
		mt_pmic_vdram1_buck_reg = "/pwrap@1000d000/mt6358-pmic/mt6358regulator/buck_vdram1";
		mt_pmic_vcore_buck_reg = "/pwrap@1000d000/mt6358-pmic/mt6358regulator/buck_vcore";
		mt_pmic_vpa_buck_reg = "/pwrap@1000d000/mt6358-pmic/mt6358regulator/buck_vpa";
		mt_pmic_vproc11_buck_reg = "/pwrap@1000d000/mt6358-pmic/mt6358regulator/buck_vproc11";
		mt_pmic_vproc12_buck_reg = "/pwrap@1000d000/mt6358-pmic/mt6358regulator/buck_vproc12";
		mt_pmic_vgpu_buck_reg = "/pwrap@1000d000/mt6358-pmic/mt6358regulator/buck_vgpu";
		mt_pmic_vs2_buck_reg = "/pwrap@1000d000/mt6358-pmic/mt6358regulator/buck_vs2";
		mt_pmic_vmodem_buck_reg = "/pwrap@1000d000/mt6358-pmic/mt6358regulator/buck_vmodem";
		mt_pmic_vs1_buck_reg = "/pwrap@1000d000/mt6358-pmic/mt6358regulator/buck_vs1";
		mt_pmic_vdram2_ldo_reg = "/pwrap@1000d000/mt6358-pmic/mt6358regulator/ldo_vdram2";
		mt_pmic_vsim1_ldo_reg = "/pwrap@1000d000/mt6358-pmic/mt6358regulator/ldo_vsim1";
		mt_pmic_vibr_ldo_reg = "/pwrap@1000d000/mt6358-pmic/mt6358regulator/ldo_vibr";
		mt_pmic_vrf12_ldo_reg = "/pwrap@1000d000/mt6358-pmic/mt6358regulator/ldo_vrf12";
		mt_pmic_vio18_ldo_reg = "/pwrap@1000d000/mt6358-pmic/mt6358regulator/ldo_vio18";
		mt_pmic_vusb_ldo_reg = "/pwrap@1000d000/mt6358-pmic/mt6358regulator/ldo_vusb";
		mt_pmic_vcamio_ldo_reg = "/pwrap@1000d000/mt6358-pmic/mt6358regulator/ldo_vcamio";
		mt_pmic_vcamd_ldo_reg = "/pwrap@1000d000/mt6358-pmic/mt6358regulator/ldo_vcamd";
		mt_pmic_vcn18_ldo_reg = "/pwrap@1000d000/mt6358-pmic/mt6358regulator/ldo_vcn18";
		mt_pmic_vfe28_ldo_reg = "/pwrap@1000d000/mt6358-pmic/mt6358regulator/ldo_vfe28";
		mt_pmic_vsram_proc11_ldo_reg = "/pwrap@1000d000/mt6358-pmic/mt6358regulator/ldo_vsram_proc11";
		mt_pmic_vcn28_ldo_reg = "/pwrap@1000d000/mt6358-pmic/mt6358regulator/ldo_vcn28";
		mt_pmic_vsram_others_ldo_reg = "/pwrap@1000d000/mt6358-pmic/mt6358regulator/ldo_vsram_others";
		mt_pmic_vsram_gpu_ldo_reg = "/pwrap@1000d000/mt6358-pmic/mt6358regulator/ldo_vsram_gpu";
		mt_pmic_vxo22_ldo_reg = "/pwrap@1000d000/mt6358-pmic/mt6358regulator/ldo_vxo22";
		mt_pmic_vefuse_ldo_reg = "/pwrap@1000d000/mt6358-pmic/mt6358regulator/ldo_vefuse";
		mt_pmic_vaux18_ldo_reg = "/pwrap@1000d000/mt6358-pmic/mt6358regulator/ldo_vaux18";
		mt_pmic_vmch_ldo_reg = "/pwrap@1000d000/mt6358-pmic/mt6358regulator/ldo_vmch";
		mt_pmic_vbif28_ldo_reg = "/pwrap@1000d000/mt6358-pmic/mt6358regulator/ldo_vbif28";
		mt_pmic_vsram_proc12_ldo_reg = "/pwrap@1000d000/mt6358-pmic/mt6358regulator/ldo_vsram_proc12";
		mt_pmic_vcama1_ldo_reg = "/pwrap@1000d000/mt6358-pmic/mt6358regulator/ldo_vcama1";
		mt_pmic_vemc_ldo_reg = "/pwrap@1000d000/mt6358-pmic/mt6358regulator/ldo_vemc";
		mt_pmic_vio28_ldo_reg = "/pwrap@1000d000/mt6358-pmic/mt6358regulator/ldo_vio28";
		mt_pmic_va12_ldo_reg = "/pwrap@1000d000/mt6358-pmic/mt6358regulator/ldo_va12";
		mt_pmic_vrf18_ldo_reg = "/pwrap@1000d000/mt6358-pmic/mt6358regulator/ldo_vrf18";
		mt_pmic_vcn33_bt_ldo_reg = "/pwrap@1000d000/mt6358-pmic/mt6358regulator/ldo_vcn33_bt";
		mt_pmic_vcn33_wifi_ldo_reg = "/pwrap@1000d000/mt6358-pmic/mt6358regulator/ldo_vcn33_wifi";
		mt_pmic_vcama2_ldo_reg = "/pwrap@1000d000/mt6358-pmic/mt6358regulator/ldo_vcama2";
		mt_pmic_vmc_ldo_reg = "/pwrap@1000d000/mt6358-pmic/mt6358regulator/ldo_vmc";
		mt_pmic_vldo28_ldo_reg = "/pwrap@1000d000/mt6358-pmic/mt6358regulator/ldo_vldo28";
		mt_pmic_vaud28_ldo_reg = "/pwrap@1000d000/mt6358-pmic/mt6358regulator/ldo_vaud28";
		mt_pmic_vsim2_ldo_reg = "/pwrap@1000d000/mt6358-pmic/mt6358regulator/ldo_vsim2";
		mt_pmic_va09_ldo_reg = "/pwrap@1000d000/mt6358-pmic/mt6358regulator/ldo_va09";
		mt6358_rtc = "/pwrap@1000d000/mt6358-pmic/mt6358_rtc";
		mt6358_misc = "/pwrap@1000d000/mt6358-pmic/mt6358_misc";
		pwraph = "/pwraphal@";
		keypad = "/kp@10010000";
		mrdump_ext_rst = "/mrdump_ext_rst";
		dvfsrc = "/dvfsrc@10012000";
		mcucfg = "/mcucfg@0c530000";
		hwrng = "/hwrng";
		mdcldma = "/mdcldma@10014000";
		md_auxadc = "/md_auxadc";
		dvfsp = "/dvfsp@00110800";
		mt_cpufreq = "/mt_cpufreq";
		gce = "/gce@10238000";
		gce_mbox = "/gce_mbox@10238000";
		goodix_fp = "/fingerprint";
		fpc = "/fpc";
		accdet = "/accdet";
		bat_gm30 = "/battery";
		dfd_cache = "/dfd_cache";
		auxadc = "/auxadc@11001000";
		apdma = "/dma-controller@11000980";
		apuart0 = "/serial@11002000";
		apuart1 = "/serial@11003000";
		i2c_common = "/i2c_common";
		i2c0 = "/i2c0@11007000";
		i2c_lcd_bias_mtk = "/i2c0@11007000/i2c_lcd_bias@3e";
		i2c1 = "/i2c1@11008000";
		i2c2 = "/i2c2@11009000";
		i2c3 = "/i2c3@1100f000";
		i2c4 = "/i2c4@11011000";
		i2c5 = "/i2c5@11016000";
		i2c6 = "/i2c6@1100d000";
		i2c7 = "/i2c7@11004000";
		i2c8 = "/i2c8@11005000";
		spi2 = "/spi2@11012000";
		spi0 = "/spi0@1100a000";
		eem_fsm = "/eem_fsm@1100b000";
		tboard_thermistor1 = "/thermal-sensor1";
		tboard_thermistor2 = "/thermal-sensor2";
		drcc = "/drcc";
		consys = "/consys@18002000";
		spi1 = "/spi1@11010000";
		spi3 = "/spi3@11013000";
		spi4 = "/spi4@11014000";
		spi5 = "/spi5@11015000";
		msdc0 = "/msdc@11230000";
		msdc1 = "/msdc@11240000";
		audio = "/audio@11220000";
		afe = "/mt6768-afe-pcm@11220000";
		mt6358_snd = "/mt6358_snd";
		sound = "/sound";
		snd_scp_spk = "/snd_scp_spk";
		mipi_rx_ana_csi0a = "/mipi_rx_ana_csi0a@11c10000";
		mipi_rx_ana_csi0b = "/mipi_rx_ana_csi0b@11c11000";
		mipi_rx_ana_csi1a = "/mipi_rx_ana_csi1a@11c12000";
		mipi_rx_ana_csi1b = "/mipi_rx_ana_csi1b@11c13000";
		mipi_rx_ana_csi2a = "/mipi_rx_ana_csi2a@11c14000";
		mipi_rx_ana_csi2b = "/mipi_rx_ana_csi2b@11c15000";
		mfg_cfg = "/mfg_cfg@13000000";
		mmsys_config = "/mmsys_config@14000000";
		disp_mutex0 = "/disp_mutex0@14001000";
		smi_larb0 = "/smi_larb0@14003000";
		mdp_rdma0 = "/mdp_rdma0@14004000";
		mdp_ccorr = "/mdp_ccorr0@14005000";
		mdp_rsz0 = "/mdp_rsz0@14006000";
		mdp_rsz1 = "/mdp_rsz1@14007000";
		mdp_wdma0 = "/mdp_wdma0@14008000";
		mdp_wrot0 = "/mdp_wrot0@14009000";
		mdp_tdshp0 = "/mdp_tdshp0@1400a000";
		disp_color0 = "/disp_color0@1400f000";
		mtkfb = "/mtkfb@0";
		dsi_te = "/dsi_te";
		imgsys = "/imgsys@15020000";
		smi_larb2 = "/smi_larb2@15021000";
		vcu = "/vcu@16000000";
		vdec_gcon = "/vdec_gcon@16000000";
		smi_larb1 = "/smi_larb1@16010000";
		venc_gcon = "/venc_gcon@17000000";
		smi_larb4 = "/smi_larb4@17010000";
		camsys = "/camsys@1a000000";
		smi_larb3 = "/smi_larb3@1a002000";
		kd_camera_hw1 = "/kd_camera_hw1@1a040000";
		flashlight_core = "/flashlight_core";
		flashlights_mt6370 = "/flashlights_mt6370";
		flashlights_aw36518 = "/flashlights_aw36518";
		odm = "/odm";
		memory_ssmr_features = "/memory-ssmr-features";
		radio_md_cfg = "/radio_md_cfg";
		mt_charger = "/mt_charger";
		lk_charger = "/lk_charger";
		charger = "/charger";
		pd_adapter = "/pd_adapter";
		rt9465_slave_chr = "/rt9465_slave_chr";
		subpmic_pmu_eint = "/mt6370_pmu_eint";
		tcpc_pd = "/tcpc_pd_eint";
		irtx_pwm = "/irtx_pwm";
		pmic_clock_buffer_ctrl = "/pmic_clock_buffer_ctrl";
		touch = "/touch";
		nfc = "/nfc";
		irq_nfc = "/irq_nfc";
		smart_pa = "/smart_pa";
		gpio_usage_mapping = "/gpio";
		md1_sim1_hot_plug_eint = "/md1_sim1_hot_plug_eint";
		md1_sim2_hot_plug_eint = "/md1_sim2_hot_plug_eint";
		prize_disp = "/prize_disp";
		rt1711_typec = "/type_c_port0";
	};
};
